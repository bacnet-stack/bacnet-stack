## zephyr/Kconfig.object
```kconfig
config BACNET_OBJECT_COMMAND
	bool "BACnet command object"
    default n
	help
	  Enable to support the command object of BACnet

config BACNET_OBJECT_SCHEDULE
	bool "BACnet schedule object"
    default n
	help
	  Enable to support the schedule object of BACnet

config BACNET_OBJECT_TRENDLOG
	bool "BACnet trendlog object"
    default n
	help
	  Enable to support the trendlog object of BACnet
```

## zephyr/manifests/zp/zephyr/west.yml
```yaml
#
# Copyright (c) 2020 Legrand North America, LLC.
#
# SPDX-License-Identifier: MIT

# The west manifest file for upstream Zephyr Project's Zephyr repo.
#
# NOTE: Requires west 0.8.0a1 or later (pip3 install west==0.8.0a1)
#
# Usage (from top of workspace):
#   west
#     --zephyr-base zephyr
#     init
#       -m https://github.com/bacnet-stack/bacnet-stack
#       --mr <desired repo branch>
#       --mf zephyr/manifests/zp/zephyr/west.yml
#       --zephyr-base zephyr
#       $workspace
#   cd $workspace
#   west update
#   source zephyr/zephyr-env.sh

manifest:
  version: 0.7
  remotes:
    - name: zephyrproject-rtos
      url-base: https://github.com/zephyrproject-rtos
  projects:
    - name: zephyr
      remote: zephyrproject-rtos
      revision: v2.3.0  # Latest integrated release
      import: true
      path: zephyr
  self:
      path: bacnet-stack
```

## zephyr/modules/Kconfig
```kconfig
# Feature configuration options for modules of BACnet-Stack

# Copyright (c) 2023 Legrand North America, LLC.
# SPDX-License-Identifier: MIT

rsource "mongoose/Kconfig"
```

## zephyr/modules/mongoose/Kconfig
```kconfig
# Feature configuration options for mongoose module

# Copyright (c) 2023 Legrand North America, LLC.
# SPDX-License-Identifier: MIT

menuconfig MONGOOSE_MODULE
	bool "MONGOOSE module"
	default y if BACDL_BSC
	help
	  Enable Zephyr module MONGOOSE

if MONGOOSE_MODULE

module = MONGOOSE
module-str = Log level for MONGOOSE module
module-help = Enable (Disable) MONGOOSE module debug message output
source "$(ZEPHYR_BASE)/subsys/logging/Kconfig.template.log_config"

config BACNET_MONGOOSE
    bool "Add mongoose lib"
    default y if BACDL_BSC
    help
      This option enables the mongoose library

endif # MONGOOSE
```

## zephyr/subsys/Kconfig
```kconfig
# Copyright (c) 2020 Legrand North America, LLC.
# SPDX-License-Identifier: MIT

# Kconfig - Subsystem configuration options

comment "BACnet Subsystems"

rsource "bacnet_settings/Kconfig"
rsource "bacnet_basic/Kconfig"
rsource "object/Kconfig"
rsource "server/Kconfig"

config BACNET_SHELL
	bool "BACnet Shell"
	default n
    select SHELL
    select CONSOLE
    select KERNEL_SHELL
    select THREAD_MONITOR
    select THREAD_NAME
    select DEVICE_SHELL
    select LOG
	help
	  Enable BACnet Shell support
```

## zephyr/subsys/bacnet_basic/Kconfig
```kconfig
# Kconfig - Subsystem configuration options
#
# @author Steve Karg <skarg@users.sourceforge.net>
# @date May 2024
# @copyright SPDX-License-Identifier: MIT
menuconfig BACNETSTACK_BACNET_BASIC
    bool "BACNETSTACK_BACNET_BASIC"
    default n
    help
      This option enables a basic BACnet Device object and tasking

if BACNETSTACK_BACNET_BASIC

    module = BACNETSTACK_BACNET_BASIC
    module-str = bacnet_basic

    config BACNET_BASIC_DEVICE_OBJECT_NAME
        string "BACnet device object default name"
        default "Basic Server"
        help
            BACnet device object default name

    config BACNET_BASIC_DEVICE_OBJECT_VERSION
        string "BACnet device object default application version string"
        default "1.0.0"
        help
            BACnet device object default application version string

    config BACNET_BASIC_DEVICE_DESCRIPTION
        string "BACnet device object default description string"
        default "BACnet Basic Server"
        help
            BACnet device object default description string

    config BACNET_BASIC_DEVICE_MODEL_NAME
        string "BACnet device object default model name string"
        default "Basic Server"
        help
            BACnet device object default model name string

    config BACNET_BASIC_DEVICE_SHELL
        bool "BACnet Basic Device subsystem shell"
        depends on BACNETSTACK
        default y if SHELL

endif # BACNETSTACK_BACNET_SETTINGS
```

## zephyr/subsys/bacnet_settings/Kconfig
```kconfig
# Kconfig - Subsystem configuration options
#
# @author Steve Karg <skarg@users.sourceforge.net>
# @date May 2024
# @copyright SPDX-License-Identifier: MIT
menuconfig BACNETSTACK_BACNET_SETTINGS
    bool "BACNETSTACK_BACNET_SETTINGS"
	default y if BACNETSTACK && SETTINGS
    help 
      This option enables BACnet Settings services

if BACNETSTACK_BACNET_SETTINGS

    module = BACNETSTACK_BACNET_SETTINGS
    module-str = bac_settings

	config BACNET_SETTINGS_BASE_NAME
		string "BACnet object path base name for every setting"
		default ".bacnet"
		help
			BACnet object path base name for every setting"

	config BACNET_SETTINGS_SHELL
		bool "BACnet settings subsystem shell"
		depends on BACNETSTACK
		default y if SHELL && SETTINGS

endif # BACNETSTACK_BACNET_SETTINGS
```

## zephyr/subsys/basic_device/Kconfig
```kconfig
# Kconfig - Subsystem configuration options
#
# @author Steve Karg <skarg@users.sourceforge.net>
# @date May 2024
# @copyright SPDX-License-Identifier: MIT
menuconfig BACNETSTACK_BASIC_DEVICE
    bool "BACNETSTACK_BASIC_DEVICE"
	default y if BACNETSTACK
    help 
      This option enables BACnet a BACnet Basic Device object

if BACNETSTACK_BASIC_DEVICE

    module = BACNETSTACK_BASIC_DEVICE
    module-str = basic_device

	config BACNET_BASIC_DEVICE_OBJECT_NAME
		string "BACnet device object default name"
		default "Basic Server"
		help
			BACnet device object default name

	config BACNET_BASIC_DEVICE_OBJECT_VERSION
		string "BACnet device object default application version string"
		default "1.0.0"
		help
			BACnet device object default application version string
			

	config BACNET_BASIC_DEVICE_SHELL
		bool "BACnet Basic Device subsystem shell"
		depends on BACNETSTACK
		default y if SHELL

endif # BACNETSTACK_BACNET_SETTINGS
```

## zephyr/subsys/net/Kconfig
```kconfig
# Copyright (c) 2022 Legrand North America, LLC.
# SPDX-License-Identifier: MIT

rsource "lib/Kconfig"
```

## zephyr/subsys/net/lib/websocket/Kconfig
```kconfig
# Copyright (c) 2022 Legrand North America, LLC.
# SPDX-License-Identifier: MIT

menuconfig BSC_WEBSOCKET
    bool "BSC_WEBSOCKET"
    default y
    select NET_SOCKETS
    select HTTP_PARSER
    select HTTP_PARSER_URL
    select HTTP_CLIENT
    select MBEDTLS
    select BASE64
    help 
      This option enables BACnet websocket protocol

if BSC_WEBSOCKET

    config BSC_WEBSOCKET_APP_PRIORITY
        int "App init priority"
        default 0
        help 
          This sets the starting priority of the thread.

    config BSC_WEBSOCKET_CLIENT
        bool "This option enables BACnet websocket client"
        default y
        select HTTP_CLIENT
        help 
          This option enables BACnet websocket client

endif # BACNETSTACK_BACNET_SERVER
```

## zephyr/subsys/object/Kconfig
```kconfig
# Feature configuration options for BACnet-Stack

# Copyright (c) 2022 Legrand North America, LLC.
# SPDX-License-Identifier: MIT


config BACNETSTACK_USE_SECTION_ITERABLE_OBJECT_TABLE
	bool "Use the Section Iterable for the Object Table"
	default y
	help
		Use the Section Iterable for the Object Table

config BACNETSTACK_USE_DYNAMIC_DESCRIPTION
	bool "Use dynalic allocate for objects descriptions"
	default n
	help
		Use dynalic allocate for objects descriptions

config BACNETSTACK_OBJECT_ACC_ENABLE
	bool "Accumulator objects"
	default n
	help
		Support accumulator objects

config BACNETSTACK_OBJECT_ACCESS_CREDENTIAL_ENABLE
	bool "Access Credential objects"
	default n
	help
		Support access credential objects

config BACNETSTACK_OBJECT_ACCESS_DOOR_ENABLE
	bool "Access Door objects"
	default n
	help
		Support access door objects

config BACNETSTACK_OBJECT_ACCESS_POINT_ENABLE
	bool "Access Point objects"
	default n
	help
		Support access point objects

config BACNETSTACK_OBJECT_ACCESS_RIGHTS_ENABLE
	bool "Access Rights objects"
	default n
	help
		Support access rights objects

config BACNETSTACK_OBJECT_ACCESS_USER_ENABLE
	bool "Access User objects"
	default n
	help
		Support access user objects

config BACNETSTACK_OBJECT_ACCESS_ZONE_ENABLE
	bool "Access Zone objects"
	default n
	help
		Support access zone objects

config BACNETSTACK_OBJECT_ANALOG_INPUT_ENABLE
	bool "Analog Input objects"
	default n
	help
		Support analog input objects

config BACNETSTACK_OBJECT_ANALOG_OUTPUT_ENABLE
	bool "Analog Output objects"
	default n
	help
		Support analog output objects

config BACNETSTACK_OBJECT_ANALOG_VALUE_ENABLE
	bool "Analog Value objects"
	default n
	help
		Support analog value objects

config BACNETSTACK_OBJECT_BACFILE_ENABLE
	bool "BACfile objects"
	default n
	help
		Support BACfile objects

config BACNETSTACK_OBJECT_BINARY_INPUT_ENABLE
	bool "Binary Input objects"
	default n
	help
		Support binary input objects

config BACNETSTACK_OBJECT_BINARY_OUTPUT_ENABLE
	bool "Binary Output objects"
	default n
	help
		Support binary output objects

config BACNETSTACK_OBJECT_BINARY_VALUE_ENABLE
	bool "Binary Value objects"
	default n
	help
		Support binary value objects

config BACNETSTACK_OBJECT_CHANNEL_ENABLE
	bool "Channel objects"
	default n
	help
		Support channel objects

config BACNETSTACK_OBJECT_COMMAND_ENABLE
	bool "Command objects"
	default n
	help
		Support command objects

config BACNETSTACK_OBJECT_CREDENTIAL_DATA_INPUT_ENABLE
	bool "Credential Data Input objects"
	default n
	help
		Support credential data input objects

config BACNETSTACK_OBJECT_CHARACTERSTRING_VALUE_ENABLE
	bool "CharacterString Value objects"
	default n
	help
		Support character-string value objects

config BACNETSTACK_OBJECT_INTEGER_VALUE_ENABLE
	bool "Integer Value objects"
	default n
	help
		Support integer value objects

config BACNETSTACK_OBJECT_LOAD_CONTROL_ENABLE
	bool "Load Control Objects"
	default n
	help
		Support load control objects

config BACNETSTACK_OBJECT_LIGHTING_OUTPUT_ENABLE
	bool "Lighting Output objects"
	default n
	help
		Support lighting output objects

config BACNETSTACK_OBJECT_LIFE_SAFETY_POINT_ENABLE
	bool "Life Safety Point objects"
	default n
	help
		Support life safety point objects

config BACNETSTACK_OBJECT_MULTISTATE_INPUT_ENABLE
	bool "Multistate Input objects"
	default n
	help
		Supportmultistate input objects

config BACNETSTACK_OBJECT_MULTISTATE_OUTPUT_ENABLE
	bool "Multistate Output objects"
	default n
	help
		Support multistate output objects

config BACNETSTACK_OBJECT_MULTISTATE_VALUE_ENABLE
	bool "Multistate Value objects"
	default n
	help
		Support multistate value objects


config BACNETSTACK_OBJECT_NOTIFICATION_CLASS_ENABLE
	bool "Notification Class objects"
	default n
	help
		Support notification class objects

config BACNETSTACK_OBJECT_OCTETSTRING_VALUE_ENABLE
	bool "OctetString Value objects"
	default n
	help
		Support octet-string value objects

config BACNETSTACK_OBJECT_POSITIVEINTEGER_VALUE_ENABLE
	bool "PositiveInteger Value objects"
	default n
	help
		Support positive-integer value objects

config BACNETSTACK_OBJECT_SCHEDULE_ENABLE
	bool "Schedule objects"
	default n
	help
		Support schedule objects

config BACNETSTACK_OBJECT_TREND_LOG_ENABLE
	bool "Trend Log objects"
	default n
	help
		Support trend log objects
```

## zephyr/subsys/server/Kconfig
```kconfig
# Copyright (c) 2020 Legrand North America, LLC.
# SPDX-License-Identifier: MIT


# Kconfig -

menuconfig BACNETSTACK_BACNET_SERVER
    bool "BACNETSTACK_BACNET_SERVER"
    help
      This option enables BACnet Server services

if BACNETSTACK_BACNET_SERVER

    module = BACNETSTACK_BACNET_SERVER
    module-str = bac_server

    config BACNETSTACK_BACNET_SERVER_APP_PRIORITY
        int "App init priority"
        default 0
        help
          This sets the starting priority of the thread.

    config BACNETSTACK_BACNET_SERVER_PRIO
        int "BACnet server thread priority"
        default 50
        help
          This sets the execution priority of the thread.

    config BACNETSTACK_BACNET_SERVER_STACK_SIZE
        int "BACnet server stack size"
        default 4096
        help
          This sets the stack size of the thread.

endif # BACNETSTACK_BACNET_SERVER
```

## zephyr/tests/bacnet/abort/testcase.yaml
```yaml
tests:
  bacnet.abort.unit:
    tags: bacnet
    type: unit
  bacnet.abort:
    tags: bacnet
```

## zephyr/tests/bacnet/alarm_ack/testcase.yaml
```yaml
tests:
  bacnet.alarm_ack.unit:
    tags: bacnet
    type: unit
  bacnet.alarm_ack:
    tags: bacnet
```

## zephyr/tests/bacnet/arf/testcase.yaml
```yaml
tests:
  bacnet.arf.unit:
    tags: bacnet
    type: unit
  bacnet.arf:
    tags: bacnet
```

## zephyr/tests/bacnet/awf/testcase.yaml
```yaml
tests:
  bacnet.awf.unit:
    tags: bacnet
    type: unit
  bacnet.awf:
    tags: bacnet
```

## zephyr/tests/bacnet/bacapp/testcase.yaml
```yaml
tests:
  bacnet.bacapp.unit:
    tags: bacnet
    type: unit
    extra_args: BACAPP_PRINT_ENABLED=1 BACAPP_SNPRINTF_ENABLED=1
  bacnet.bacapp:
    tags: bacnet
```

## zephyr/tests/bacnet/bacdcode/testcase.yaml
```yaml
tests:
  bacnet.bacdcode.unit:
    tags: bacnet
    type: unit
  bacnet.bacdcode:
    tags: bacnet
```

## zephyr/tests/bacnet/bacdevobjpropref/testcase.yaml
```yaml
tests:
  bacnet.bacdevobjpropref.unit:
    tags: bacnet
    type: unit
  bacnet.bacdevobjpropref:
    tags: bacnet
```

## zephyr/tests/bacnet/bacerror/testcase.yaml
```yaml
tests:
  bacnet.bacerror.unit:
    tags: bacnet
    type: unit
  bacnet.bacerror:
    tags: bacnet
```

## zephyr/tests/bacnet/bacint/testcase.yaml
```yaml
tests:
  bacnet.bacint.unit:
    tags: bacnet
    type: unit
  bacnet.bacint:
    tags: bacnet
```

## zephyr/tests/bacnet/bacpropstates/testcase.yaml
```yaml
tests:
  bacnet.bacpropstates.unit:
    tags: bacnet
    type: unit
  bacnet.bacpropstates:
    tags: bacnet
```

## zephyr/tests/bacnet/bacreal/testcase.yaml
```yaml
tests:
  bacnet.bacreal.unit:
    tags: bacnet
    type: unit
  bacnet.bacreal:
    tags: bacnet
```
