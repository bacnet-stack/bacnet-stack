## zephyr/tests/bacnet/whohas/testcase.yaml
```yaml
tests:
  bacnet.whohas:
    tags: bacnet
  bacnet.whohas.unit:
    tags: bacnet
    type: unit
```

## zephyr/tests/bacnet/whois/testcase.yaml
```yaml
tests:
  bacnet.whois:
    tags: bacnet
  bacnet.whois.unit:
    tags: bacnet
    type: unit
```

## zephyr/tests/bacnet/wp/testcase.yaml
```yaml
tests:
  bacnet.wp:
    tags: bacnet
  bacnet.wp.unit:
    tags: bacnet
    type: unit
```
