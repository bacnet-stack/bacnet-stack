## CMakeLists.txt
```
# SPDX-License-Identifier: MIT

cmake_minimum_required(VERSION 3.13.1)

# Extract module path and names
string(REGEX REPLACE
  "/zephyr/tests/[a-zA-Z_/-]*$" ""
  BACNET_BASE
  ${CMAKE_CURRENT_SOURCE_DIR})
string(REGEX REPLACE
  "/zephyr/tests/" "/src/"
  BACNET_SRC_PATH
  ${CMAKE_CURRENT_SOURCE_DIR})
string(REGEX REPLACE
  "/zephyr/tests/" "/test/"
  BACNET_TEST_PATH
  ${CMAKE_CURRENT_SOURCE_DIR})
get_filename_component(BACNET_NAME ${BACNET_BASE} NAME)

add_compile_definitions(
  BIG_ENDIAN=0
  #CONFIG_ZTEST=1
  MAX_BACFILES=4
  BSC_CONF_WSURL_MAX_LEN=127
  BSC_CONF_WEBSOCKET_ERR_DESC_STR_MAX_LEN=128
  BSC_CONF_HUB_FUNCTION_CONNECTIONS_NUM=3
  BSC_CONF_NODE_SWITCH_CONNECTIONS_NUM=3
  BSC_CONF_WEBSOCKET_SERVERS_NUM=6
  BSC_CONF_HUB_CONNECTORS_NUM=4
  BSC_CONF_HUB_FUNCTIONS_NUM=4
  BSC_CONF_NODES_NUM=4
  BSC_CONF_NODE_SWITCHES_NUM=4
  BSC_CONF_FAILED_CONNECTION_STATUS_MAX_NUM=1
  BSC_CONF_HUB_FUNCTION_CONNECTION_STATUS_MAX_NUM=2
  BSC_CONF_NODE_SWITCH_CONNECTION_STATUS_MAX_NUM=2
  MAX_TSM_TRANSACTIONS=0
  BACDL_BSC
  ZEPHYR_PLATFORM
  MBEDTLS_ERROR_C
  BSC_CONF_CLIENT_CONNECTIONS_NUM=8
  BSC_CONF_SERVER_HUB_CONNECTIONS_MAX_NUM=4
  )

if(BOARD STREQUAL unit_testing)
  get_filename_component(BACNET_DATALINK_PATH ${BACNET_SRC_PATH} PATH)

  file(RELATIVE_PATH BACNET_INCLUDE $ENV{ZEPHYR_BASE} ${BACNET_BASE}/src)
  list(APPEND INCLUDE ${BACNET_INCLUDE})
  list(APPEND SOURCES
    ${BACNET_BASE}/ports/zephyr/websocket-cli.c
    ${BACNET_BASE}/ports/zephyr/websocket-srv.c
    ${BACNET_BASE}/ports/zephyr/websocket-mutex.c
    ${BACNET_BASE}/ports/zephyr/bsc-event.c
    ${BACNET_BASE}/ports/zephyr/mstimer-init.c
    ${BACNET_BASE}/ports/zephyr/datetime-init.c
    ${BACNET_DATALINK_PATH}/bsc/bsc-util.c
    ${BACNET_DATALINK_PATH}/bsc/bvlc-sc.c
    ${BACNET_DATALINK_PATH}/bsc/bsc-socket.c
    ${BACNET_DATALINK_PATH}/bsc/bsc-hub-connector.c
    ${BACNET_DATALINK_PATH}/bsc/bsc-hub-function.c
    ${BACNET_DATALINK_PATH}/bsc/bsc-node-switch.c
    ${BACNET_DATALINK_PATH}/bsc/bsc-node.c
    ${BACNET_DATALINK_PATH}/bsc/bsc-datalink.c
    ${BACNET_SRC_PATH}/basic/service/h_apdu.c
    ${BACNET_SRC_PATH}/basic/object/bacfile.c
    ${BACNET_SRC_PATH}/basic/object/netport.c
    ${BACNET_SRC_PATH}/basic/object/sc_netport.c
    ${BACNET_SRC_PATH}/basic/sys/days.c
    ${BACNET_SRC_PATH}/basic/sys/debug.c
    ${BACNET_SRC_PATH}/basic/sys/fifo.c
    ${BACNET_SRC_PATH}/basic/sys/keylist.c
    ${BACNET_SRC_PATH}/basic/sys/mstimer.c
    ${BACNET_SRC_PATH}/arf.c
    ${BACNET_SRC_PATH}/bacapp.c
    ${BACNET_SRC_PATH}/bacaddr.c
    ${BACNET_SRC_PATH}/bacdcode.c
    ${BACNET_SRC_PATH}/bacdevobjpropref.c
    ${BACNET_SRC_PATH}/bacerror.c
    ${BACNET_SRC_PATH}/bacint.c
    ${BACNET_SRC_PATH}/bacreal.c
    ${BACNET_SRC_PATH}/bacstr.c
    ${BACNET_SRC_PATH}/bactext.c
    ${BACNET_SRC_PATH}/datetime.c
    ${BACNET_SRC_PATH}/bactimevalue.c
    ${BACNET_SRC_PATH}/weeklyschedule.c
    ${BACNET_SRC_PATH}/dailyschedule.c
    ${BACNET_SRC_PATH}/dcc.c
    ${BACNET_SRC_PATH}/indtext.c
    ${BACNET_SRC_PATH}/hostnport.c
    ${BACNET_SRC_PATH}/lighting.c
    ${BACNET_SRC_PATH}/npdu.c
    ${BACNET_SRC_PATH}/proplist.c
    ${BACNET_SRC_PATH}/timestamp.c
    ${BACNET_SRC_PATH}/wp.c
    # Test and test library files
    ${BACNET_TEST_PATH}/src/main.c
    ${CMAKE_CURRENT_SOURCE_DIR}/src/utils.c
    )

  include($ENV{ZEPHYR_BASE}/subsys/testsuite/unittest.cmake)
  project(${BACNET_NAME})
else()
  find_package(Zephyr REQUIRED HINTS $ENV{ZEPHYR_BASE})
  project(${BACNET_NAME})

  target_include_directories(app PRIVATE ${BACNET_BASE}/src)
  target_sources(app PRIVATE
    ${BACNET_TEST_PATH}/src/main.c
    ${CMAKE_CURRENT_SOURCE_DIR}/src/utils.c
    )
endif()
```

## prj.conf
```kconfig
CONFIG_ZTEST=y
CONFIG_ZTEST_NEW_API=y
CONFIG_BACNETSTACK=y
CONFIG_HEAP_MEM_POOL_SIZE=100000
CONFIG_MAIN_STACK_SIZE=20000
CONFIG_INIT_STACKS=y

# Debugging stuff (can be commented out)
CONFIG_DEBUG=n
CONFIG_LOG=y
CONFIG_LOG_MODE_IMMEDIATE=y
CONFIG_LOG_DEFAULT_LEVEL=2
CONFIG_LOG_MODE_MINIMAL=y
#CONFIG_NO_OPTIMIZATIONS=y
CONFIG_ASSERT=n                        #does not work with CONFIG_LOG_MODE_IMMEDIATE=y

# Debug config (can be commented out)
#CONFIG_NET_LOG=y
CONFIG_BACNETSTACK_LOG_LEVEL_OFF=y
#CONFIG_NET_SOCKETS_LOG_LEVEL_DBG=y
#CONFIG_NET_CONTEXT_LOG_LEVEL_DBG=y
#CONFIG_MBEDTLS_DEBUG=y
#CONFIG_MBEDTLS_LOG_LEVEL_DBG=y
#CONFIG_NET_DEBUG_NET_PKT_ALLOC=y
#CONFIG_NET_PKT_LOG_LEVEL_DBG=y
#CONFIG_NET_TCP_LOG_LEVEL_DBG=y
#CONFIG_NET_WEBSOCKET_LOG_LEVEL_OFF=y
CONFIG_FS_LOG_LEVEL_OFF=y

#CONFIG_POSIX_API=y                   #does not work with CONFIG_BACDL_BSC=y
CONFIG_POSIX_MAX_FDS=60

# TLS configuration
CONFIG_MBEDTLS=y
CONFIG_MBEDTLS_BUILTIN=y
CONFIG_MBEDTLS_ENABLE_HEAP=y
CONFIG_MBEDTLS_HEAP_SIZE=256000
#CONFIG_MBEDTLS_SSL_MAX_CONTENT_LEN=16384
CONFIG_MBEDTLS_SSL_MAX_CONTENT_LEN=2048
CONFIG_NET_SOCKETS_TLS_SET_MAX_FRAGMENT_LENGTH=y

CONFIG_MBEDTLS_ECP_C=y
CONFIG_MBEDTLS_ECDH_C=y
CONFIG_MBEDTLS_ECDSA_C=y
CONFIG_MBEDTLS_ECJPAKE_C=y

CONFIG_MBEDTLS_TLS_VERSION_1_2=y
CONFIG_MBEDTLS_KEY_EXCHANGE_ALL_ENABLED=y
CONFIG_MBEDTLS_CIPHER_ALL_ENABLED=y
CONFIG_MBEDTLS_ECP_ALL_ENABLED=y
CONFIG_MBEDTLS_MAC_ALL_ENABLED=y
CONFIG_MBEDTLS_GENPRIME_ENABLED=y
CONFIG_MBEDTLS_HMAC_DRBG_ENABLED=y
CONFIG_MBEDTLS_PEM_CERTIFICATE_FORMAT=y

# Networking config
CONFIG_NETWORKING=y
CONFIG_NET_IPV4=y
CONFIG_NET_IPV6=n
CONFIG_NET_TCP=y
CONFIG_NET_SHELL=y
CONFIG_NET_STATISTICS=y

CONFIG_NET_PKT_RX_COUNT=200
CONFIG_NET_PKT_TX_COUNT=200
CONFIG_NET_BUF_RX_COUNT=512
CONFIG_NET_BUF_TX_COUNT=512
#CONFIG_NET_UDP=y
#CONFIG_SLIP_TAP=y
CONFIG_NET_MAX_CONN=20
CONFIG_NET_MAX_CONTEXTS=20

# Sockets
CONFIG_NET_SOCKETS=y
CONFIG_NET_SOCKETS_POSIX_NAMES=y
CONFIG_NET_SOCKETS_POLL_MAX=20
CONFIG_NET_SOCKETPAIR=y
CONFIG_NET_SOCKETPAIR_BUFFER_SIZE=16
CONFIG_NET_SOCKETS_SOCKOPT_TLS=y

# Network driver config
CONFIG_ENTROPY_GENERATOR=y

# Network address config
CONFIG_NET_CONFIG_SETTINGS=y
CONFIG_NET_CONFIG_NEED_IPV4=y

CONFIG_NET_CONFIG_MY_IPV4_ADDR="192.0.2.1"
CONFIG_NET_CONFIG_MY_IPV4_GW="192.0.2.2"

# Bacnet Websocket
CONFIG_BACDL_BSC=y
CONFIG_WEBSOCKET_CLIENT=y
CONFIG_WEBSOCKET_MAX_CONTEXTS=16

# Filesystem
CONFIG_FLASH=y
CONFIG_FLASH_MAP=y
CONFIG_FLASH_PAGE_LAYOUT=y
CONFIG_FILE_SYSTEM=y
CONFIG_FILE_SYSTEM_LITTLEFS=y

CONFIG_TLS_MAX_CREDENTIALS_NUMBER=64
CONFIG_NET_SOCKETS_TLS_MAX_CONTEXTS=16
```

## src/utils.c
```c
/*
 * Copyright (c) 2023 Legrand North America, LLC.
 *
 * SPDX-License-Identifier: MIT
 */

/* @file
 * @author Mikhail Antropov
 */

#include <zephyr/kernel.h>
#include <zephyr/logging/log.h>
#include <zephyr/device.h>
#include <zephyr/fs/fs.h>
#include <zephyr/fs/littlefs.h>
#include <zephyr/storage/flash_map.h>
#include "bacnet/basic/sys/debug.h"

#define MNTP  "/lfs"
FS_LITTLEFS_DECLARE_DEFAULT_CONFIG(storage);
static struct fs_mount_t mnt = {
    .type = FS_LITTLEFS,
    .fs_data = &storage,
    .storage_dev = (void *)FIXED_PARTITION_ID(storage_partition),
    .mnt_point = MNTP,
};

static int littlefs_flash_erase(unsigned int id)
{
    const struct flash_area *pfa;
    int rc;

    rc = flash_area_open(id, &pfa);
    if (rc < 0) {
        debug_printf("FAIL: unable to find flash area %u: %d\n",
            id, rc);
        return rc;
    }

    debug_printf("Area %u at 0x%x on %s for %u bytes\n",
           id, (unsigned int)pfa->fa_off, pfa->fa_dev->name,
           (unsigned int)pfa->fa_size);

    /* Optional wipe flash contents */
    if (IS_ENABLED(CONFIG_APP_WIPE_STORAGE)) {
        rc = flash_area_erase(pfa, 0, pfa->fa_size);
        debug_printf("Erasing flash area ... %d", rc);
    }

    flash_area_close(pfa);
    return rc;
}

bool init_zephyr_env(void)
{
    int rc;

    rc = littlefs_flash_erase((uintptr_t)mnt.storage_dev);
    if (rc < 0) {
        return false;
    }

    rc = fs_mount(&mnt);
    if (rc != 0) {
        debug_printf("Error mounting fs [%d]", rc);
        return false;
    }

    return true;
}
```
