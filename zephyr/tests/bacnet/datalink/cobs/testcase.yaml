## zephyr/tests/bacnet/datalink/cobs/testcase.yaml
```yaml
tests:
  bacnet.datalink.cobs.unit:
    tags: bacnet
    type: unit
  bacnet.datalink.cobs:
    tags: bacnet
```

## zephyr/tests/bacnet/datalink/crc/testcase.yaml
```yaml
common:
  tags: bacnet
tests:
  bacnet.datalink.crc.unit:
    type: unit
  bacnet.datalink.crc.use_tables.unit:
    type: unit
    extra_args: CRC_USE_TABLE=1
  bacnet.datalink.crc:
    tags: bacnet
  bacnet.datalink.crc.use_tables:
    extra_args: CRC_USE_TABLE=1
```

## zephyr/tests/bacnet/datalink/hub-sc/testcase.yaml
```yaml
common:
  tags: bacnet
tests:
  bacnet.datalink.hub-sc.unit:
    type: unit
    skip: true
  bacnet.datalink.hub-sc:
    tags: bacnet
```

## zephyr/tests/bacnet/datalink/mock/testcase.yaml
```yaml
common:
  skip: true  #TODO: debug test for Zephyr v3.2.0
tests:
  bacnet.datalink.mock.unit:
    tags: bacnet
    type: unit
      #extra_args: EXTRA_CFLAGS='-Wno-error=array-compare'  # for zephyr_v3.0.0 net_if.c
    skip: true # TODO: Remove once unit test builds/runs under Zephyr CI
  bacnet.datalink.mock:
    tags: bacnet
      #extra_args: EXTRA_CFLAGS='-Wno-error=array-compare'  # for zephyr_v3.0.0 net_if.c
```

## zephyr/tests/bacnet/datalink/websockets/testcase.yaml
```yaml
common:
  tags: bacnet
tests:
  bacnet.datalink.websockets.unit:
    type: unit
    skip: true
  bacnet.datalink.websockets:
    tags: bacnet
```

## zephyr/tests/bacnet/datetime/testcase.yaml
```yaml
tests:
  bacnet.datetime:
    tags: bacnet
  bacnet.datetime.unit:
    tags: bacnet
    type: unit
```

## zephyr/tests/bacnet/dcc/testcase.yaml
```yaml
tests:
  bacnet.dcc:
    tags: bacnet
  bacnet.dcc.unit:
    tags: bacnet
    type: unit
```

## zephyr/tests/bacnet/event/testcase.yaml
```yaml
tests:
  bacnet.event:
    tags: bacnet
  bacnet.event.unit:
    tags: bacnet
    type: unit
```

## zephyr/tests/bacnet/getevent/testcase.yaml
```yaml
tests:
  bacnet.getevent:
    tags: bacnet
  bacnet.getevent.unit:
    tags: bacnet
    type: unit
```

## zephyr/tests/bacnet/iam/testcase.yaml
```yaml
tests:
  bacnet.iam:
    tags: bacnet
  bacnet.iam.unit:
    tags: bacnet
    type: unit
```

## zephyr/tests/bacnet/ihave/testcase.yaml
```yaml
tests:
  bacnet.ihave:
    tags: bacnet
  bacnet.ihave.unit:
    tags: bacnet
    type: unit
```

## zephyr/tests/bacnet/indtext/testcase.yaml
```yaml
tests:
  bacnet.indtext.unit:
    tags: bacnet
    type: unit
  bacnet.indtext:
    tags: bacnet
```

## zephyr/tests/bacnet/lighting/testcase.yaml
```yaml
tests:
  bacnet.lighting:
    tags: bacnet
  bacnet.lighting.unit:
    tags: bacnet
    type: unit
```

## zephyr/tests/bacnet/lso/testcase.yaml
```yaml
tests:
  bacnet.lso:
    tags: bacnet
  bacnet.lso.unit:
    tags: bacnet
    type: unit
```

## zephyr/tests/bacnet/memcopy/testcase.yaml
```yaml
tests:
  bacnet.memcopy.unit:
    tags: bacnet
    type: unit
  bacnet.memcopy:
    tags: bacnet
```

## zephyr/tests/bacnet/npdu/testcase.yaml
```yaml
tests:
  bacnet.npdu:
    tags: bacnet
  bacnet.npdu.unit:
    tags: bacnet
    type: unit
```

## zephyr/tests/bacnet/property/testcase.yaml
```yaml
tests:
  bacnet.property:
    tags: bacnet
  bacnet.property.unit:
    tags: bacnet
    type: unit
```

## zephyr/tests/bacnet/ptransfer/testcase.yaml
```yaml
tests:
  bacnet.ptransfer:
    tags: bacnet
  bacnet.ptransfer.unit:
    tags: bacnet
    type: unit
```

## zephyr/tests/bacnet/rd/testcase.yaml
```yaml
tests:
  bacnet.rd:
    tags: bacnet
  bacnet.rd.unit:
    tags: bacnet
    type: unit
```

## zephyr/tests/bacnet/reject/testcase.yaml
```yaml
tests:
  bacnet.reject.unit:
    tags: bacnet
    type: unit
  bacnet.reject:
    tags: bacnet
```

## zephyr/tests/bacnet/rp/testcase.yaml
```yaml
tests:
  bacnet.rp:
    tags: bacnet
  bacnet.rp.unit:
    tags: bacnet
    type: unit
```

## zephyr/tests/bacnet/rpm/testcase.yaml
```yaml
tests:
  bacnet.rpm:
    tags: bacnet
  bacnet.rpm.unit:
    tags: bacnet
    type: unit
```

## zephyr/tests/bacnet/timestamp/testcase.yaml
```yaml
tests:
  bacnet.timestamp:
    tags: bacnet
  bacnet.timestamp.unit:
    tags: bacnet
    type: unit
```

## zephyr/tests/bacnet/timesync/testcase.yaml
```yaml
tests:
  bacnet.timesync:
    tags: bacnet
  bacnet.timesync.unit:
    tags: bacnet
    type: unit
```
