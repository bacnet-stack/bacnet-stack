## zephyr/tests/bacnet/basic/object/ms-input/testcase.yaml
```yaml
tests:
  bacnet.basic.object.ms-input:
    tags: bacnet
  bacnet.basic.object.ms-input.unit:
    tags: bacnet
    type: unit
```

## zephyr/tests/bacnet/basic/object/mso/testcase.yaml
```yaml
tests:
  bacnet.basic.object.mso:
    tags: bacnet
  bacnet.basic.object.mso.unit:
    tags: bacnet
    type: unit
    skip: true # TODO: Remove once unit test builds/runs under Zephyr CI
```

## zephyr/tests/bacnet/basic/object/msv/testcase.yaml
```yaml
tests:
  bacnet.basic.object.msv:
    tags: bacnet
  bacnet.basic.object.msv.unit:
    tags: bacnet
    type: unit
```

## zephyr/tests/bacnet/basic/object/netport/testcase.yaml
```yaml
tests:
  bacnet.basic.object.netport:
    tags: bacnet
    extra_args: EXTRA_CFLAGS='-Wno-error=array-compare'  # for zephyr_v3.0.0 net_if.c
  bacnet.basic.object.netport.unit:
    tags: bacnet
    type: unit
    extra_args: EXTRA_CFLAGS='-Wno-error=array-compare'  # for zephyr_v3.0.0 net_if.c
    skip: true # TODO: Remove once unit test builds/runs under Zephyr CI
```

## zephyr/tests/bacnet/basic/object/objects/testcase.yaml
```yaml
tests:
  bacnet.basic.object.objects:
    tags: bacnet
  bacnet.basic.object.objects.unit:
    tags: bacnet
    type: unit
```

## zephyr/tests/bacnet/basic/object/osv/testcase.yaml
```yaml
tests:
  bacnet.basic.object.osv:
    tags: bacnet
  bacnet.basic.object.osv.unit:
    tags: bacnet
    type: unit
```

## zephyr/tests/bacnet/basic/object/piv/testcase.yaml
```yaml
tests:
  bacnet.basic.object.piv:
    tags: bacnet
  bacnet.basic.object.piv.unit:
    tags: bacnet
    type: unit
```

## zephyr/tests/bacnet/basic/object/schedule/testcase.yaml
```yaml
tests:
  bacnet.basic.object.schedule:
    tags: bacnet
  bacnet.basic.object.schedule.unit:
    tags: bacnet
    type: unit
```

## zephyr/tests/bacnet/basic/object/time_value/testcase.yaml
```yaml
tests:
  bacnet.basic.object.time_value:
    tags: bacnet
  bacnet.basic.object.time_value.unit:
    tags: bacnet
    type: unit
```

## zephyr/tests/bacnet/basic/sys/bsc_event/testcase.yaml
```yaml
tests:
  bacnet.basic.sys.bsc_event.unit:
    tags: bacnet
    type: unit
    skip: true
  bacnet.basic.sys.event:
    tags: bacnet
```

## zephyr/tests/bacnet/basic/sys/bsc_mutex/testcase.yaml
```yaml
tests:
  bacnet.basic.sys.bsc_mutex.unit:
    tags: bacnet
    type: unit
  bacnet.basic.sys.mutex:
    tags: bacnet
```

## zephyr/tests/bacnet/basic/sys/color_rgb/testcase.yaml
```yaml
tests:
  bacnet.basic.sys.color_rgb.unit:
    tags: bacnet
    type: unit
    skip: true
  bacnet.basic.sys.color_rgb:
    tags: bacnet
```

## zephyr/tests/bacnet/basic/sys/days/testcase.yaml
```yaml
tests:
  bacnet.basic.sys.days.unit:
    tags: bacnet
    type: unit
  bacnet.basic.sys.days:
    tags: bacnet
```

## zephyr/tests/bacnet/basic/sys/fifo/testcase.yaml
```yaml
tests:
  bacnet.basic.sys.fifo.unit:
    tags: bacnet
    type: unit
  bacnet.basic.sys.fifo:
    tags: bacnet
```

## zephyr/tests/bacnet/basic/sys/filename/testcase.yaml
```yaml
tests:
  bacnet.basic.sys.filename.unit:
    tags: bacnet
    type: unit
  bacnet.basic.sys.filename:
    tags: bacnet
```

## zephyr/tests/bacnet/basic/sys/key/testcase.yaml
```yaml
tests:
  bacnet.basic.sys.key.unit:
    tags: bacnet
    type: unit
  bacnet.basic.sys.key:
    tags: bacnet
```

## zephyr/tests/bacnet/basic/sys/keylist/testcase.yaml
```yaml
tests:
  bacnet.basic.sys.keylist.unit:
    tags: bacnet
    type: unit
  bacnet.basic.sys.keylist:
    tags: bacnet
```

## zephyr/tests/bacnet/basic/sys/ringbuf/testcase.yaml
```yaml
tests:
  bacnet.basic.sys.ringbuf.unit:
    tags: bacnet
    type: unit
  bacnet.basic.sys.ringbuf:
    tags: bacnet
```

## zephyr/tests/bacnet/basic/sys/sbuf/testcase.yaml
```yaml
tests:
  bacnet.basic.sys.sbuf.unit:
    tags: bacnet
    type: unit
  bacnet.basic.sys.sbuf:
    tags: bacnet
```

## zephyr/tests/bacnet/cov/testcase.yaml
```yaml
tests:
  bacnet.cov.unit:
    tags: bacnet
    type: unit
  bacnet.cov:
    tags: bacnet
```

## zephyr/tests/bacnet/datalink/bsc-datalink/testcase.yaml
```yaml
common:
  tags: bacnet
tests:
  bacnet.datalink.bsc-datalink.unit:
    type: unit
    skip: true
  bacnet.datalink.bsc-datalink:
    tags: bacnet
```

## zephyr/tests/bacnet/datalink/bsc-node/testcase.yaml
```yaml
common:
  tags: bacnet
tests:
  bacnet.datalink.bsc-node.unit:
    type: unit
    skip: true
  bacnet.datalink.bsc-node:
    tags: bacnet
```

## zephyr/tests/bacnet/datalink/bsc-socket/testcase.yaml
```yaml
common:
  tags: bacnet
tests:
  bacnet.datalink.bsc-socket.unit:
    type: unit
    skip: true
  bacnet.datalink.bsc-socket:
    tags: bacnet
```

## zephyr/tests/bacnet/datalink/bvlc-sc/testcase.yaml
```yaml
tests:
  bacnet.datalink.bvlc-sc.unit:
    tags: bacnet
    type: unit
    skip: true
    #extra_args: EXTRA_CFLAGS='-Wno-error=array-compare'  # for zephyr_v3.0.0 net_if.c
  bacnet.datalink.bvlc-sc:
    tags: bacnet
    #extra_args: EXTRA_CFLAGS='-Wno-error=array-compare'  # for zephyr_v3.0.0 net_if.c
```

## zephyr/tests/bacnet/datalink/bvlc/testcase.yaml
```yaml
common:
  skip: true  # TODO: Remove skip when zephyr v3.0.0 nested <time.h> conflicting definitions resolved.
tests:
  bacnet.datalink.bvlc.unit:
    tags: bacnet
    type: unit
    extra_args: EXTRA_CFLAGS='-Wno-error=array-compare'  # for zephyr_v3.0.0 net_if.c
  bacnet.datalink.bvlc:
    tags: bacnet
    extra_args: EXTRA_CFLAGS='-Wno-error=array-compare'  # for zephyr_v3.0.0 net_if.c
```
