## zephyr/tests/bacnet/bacstr/testcase.yaml
```yaml
tests:
  bacnet.bacstr.unit:
    tags: bacnet
    type: unit
  bacnet.bacstr:
    tags: bacnet
```

## zephyr/tests/bacnet/basic/binding/address/testcase.yaml
```yaml
tests:
  bacnet.basic.binding.address:
    tags: bacnet
  bacnet.basic.binding.address.unit:
    tags: bacnet
    type: unit
  bacnet.basic.binding.address.cache_file:
    tags: bacnet
    extra_args: BACNET_ADDRESS_CACHE_FILE=1
  bacnet.basic.binding.address.cache_file.unit:
    tags: bacnet
    type: unit
    extra_args: BACNET_ADDRESS_CACHE_FILE=1
```

## zephyr/tests/bacnet/basic/object/acc/testcase.yaml
```yaml
tests:
  bacnet.basic.object.acc:
    tags: bacnet
  bacnet.basic.object.acc.unit:
    tags: bacnet
    type: unit
```

## zephyr/tests/bacnet/basic/object/access_credential/testcase.yaml
```yaml
tests:
  bacnet.basic.object.access_credential:
    tags: bacnet
  bacnet.basic.object.access_credential.unit:
    tags: bacnet
    type: unit
```

## zephyr/tests/bacnet/basic/object/access_door/testcase.yaml
```yaml
tests:
  bacnet.basic.object.access_door:
    tags: bacnet
  bacnet.basic.object.access_door.unit:
    tags: bacnet
    type: unit
```

## zephyr/tests/bacnet/basic/object/access_point/testcase.yaml
```yaml
tests:
  bacnet.basic.object.access_point:
    tags: bacnet
  bacnet.basic.object.access_point.unit:
    tags: bacnet
    type: unit
```

## zephyr/tests/bacnet/basic/object/access_rights/testcase.yaml
```yaml
tests:
  bacnet.basic.object.access_rights:
    tags: bacnet
  bacnet.basic.object.access_rights.unit:
    tags: bacnet
    type: unit
```

## zephyr/tests/bacnet/basic/object/access_user/testcase.yaml
```yaml
tests:
  bacnet.basic.object.access_user:
    tags: bacnet
  bacnet.basic.object.access_user.unit:
    tags: bacnet
    type: unit
```

## zephyr/tests/bacnet/basic/object/access_zone/testcase.yaml
```yaml
tests:
  bacnet.basic.object.access_zone:
    tags: bacnet
  bacnet.basic.object.access_zone.unit:
    tags: bacnet
    type: unit
```

## zephyr/tests/bacnet/basic/object/ai/testcase.yaml
```yaml
tests:
  bacnet.basic.object.ai:
    tags: bacnet
  bacnet.basic.object.ai.unit:
    tags: bacnet
    type: unit
```

## zephyr/tests/bacnet/basic/object/ao/testcase.yaml
```yaml
tests:
  bacnet.basic.object.ao:
    tags: bacnet
  bacnet.basic.object.ao.unit:
    tags: bacnet
    type: unit
    skip: true # TODO: Remove once unit test builds/runs under Zephyr CI
```

## zephyr/tests/bacnet/basic/object/auditlog/testcase.yaml
```yaml
tests:
  bacnet.basic.object.auditlog:
    tags: bacnet
    extra_args: EXTRA_CFLAGS='-Wno-error=array-compare'  # for zephyr_v3.0.0 net_if.c
  bacnet.basic.object.auditlog.unit:
    tags: bacnet
    type: unit
    extra_args: EXTRA_CFLAGS='-Wno-error=array-compare'  # for zephyr_v3.0.0 net_if.c
    skip: true # TODO: Remove once unit test builds/runs under Zephyr CI
```

## zephyr/tests/bacnet/basic/object/av/testcase.yaml
```yaml
tests:
  bacnet.basic.object.av:
    tags: bacnet
  bacnet.basic.object.av.unit:
    tags: bacnet
    type: unit
```

## zephyr/tests/bacnet/basic/object/bi/testcase.yaml
```yaml
tests:
  bacnet.basic.object.bi:
    tags: bacnet
  bacnet.basic.object.bi.unit:
    tags: bacnet
    type: unit
```

## zephyr/tests/bacnet/basic/object/bo/testcase.yaml
```yaml
tests:
  bacnet.basic.object.bo:
    tags: bacnet
  bacnet.basic.object.bo.unit:
    tags: bacnet
    type: unit
    skip: true # TODO: Remove once unit test builds/runs under Zephyr CI
```

## zephyr/tests/bacnet/basic/object/bv/testcase.yaml
```yaml
tests:
  bacnet.basic.object.bv:
    tags: bacnet
  bacnet.basic.object.bv.unit:
    tags: bacnet
    type: unit
```

## zephyr/tests/bacnet/basic/object/calendar/testcase.yaml
```yaml
tests:
  bacnet.basic.object.calendar:
    tags: bacnet
  bacnet.basic.object.calendar.unit:
    tags: bacnet
    type: unit
```

## zephyr/tests/bacnet/basic/object/color_object/testcase.yaml
```yaml
tests:
  bacnet.basic.object.color_object:
    tags: bacnet
  bacnet.basic.object.color_object.unit:
    tags: bacnet
    type: unit
```

## zephyr/tests/bacnet/basic/object/color_temperature/testcase.yaml
```yaml
tests:
  bacnet.basic.object.color_temperature:
    tags: bacnet
  bacnet.basic.object.color_temperature.unit:
    tags: bacnet
    type: unit
```

## zephyr/tests/bacnet/basic/object/command/testcase.yaml
```yaml
tests:
  bacnet.basic.object.command:
    tags: bacnet
  bacnet.basic.object.command.unit:
    tags: bacnet
    type: unit
```

## zephyr/tests/bacnet/basic/object/credential_data_input/testcase.yaml
```yaml
tests:
  bacnet.basic.object.credential_data_input:
    tags: bacnet
  bacnet.basic.object.credential_data_input.unit:
    tags: bacnet
    type: unit
```

## zephyr/tests/bacnet/basic/object/device/testcase.yaml
```yaml
tests:
  bacnet.basic.object.device:
    tags: bacnet
  bacnet.basic.object.device.unit:
    tags: bacnet
    type: unit
    skip: true # TODO: Remove once unit test builds/runs under Zephyr CI
```

## zephyr/tests/bacnet/basic/object/lc/testcase.yaml
```yaml
tests:
  bacnet.basic.object.lc:
    tags: bacnet
  bacnet.basic.object.lc.unit:
    tags: bacnet
    type: unit
    skip: true # TODO: Remove once unit test builds/runs under Zephyr CI
```

## zephyr/tests/bacnet/basic/object/lo/testcase.yaml
```yaml
tests:
  bacnet.basic.object.lo:
    tags: bacnet
  bacnet.basic.object.lo.unit:
    tags: bacnet
    type: unit
```

## zephyr/tests/bacnet/basic/object/lsp/testcase.yaml
```yaml
tests:
  bacnet.basic.object.lsp:
    tags: bacnet
  bacnet.basic.object.lsp.unit:
    tags: bacnet
    type: unit
```
