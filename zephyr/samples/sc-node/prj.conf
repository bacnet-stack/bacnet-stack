## CMakeLists.txt
```
# SPDX-License-Identifier: MIT

cmake_minimum_required(VERSION 3.13.1)

get_filename_component(MY_PROJECT_NAME ${CMAKE_CURRENT_SOURCE_DIR} NAME)

find_package(Zephyr REQUIRED HINTS $ENV{ZEPHYR_BASE})
project(${MY_PROJECT_NAME})

target_sources(app PRIVATE src/main.c)

string(REGEX REPLACE
  "/zephyr/samples/[a-zA-Z_/-]*$" "/bin/certs"
  CERTS_DIR
  ${CMAKE_CURRENT_SOURCE_DIR})

set(gen_dir ${ZEPHYR_BINARY_DIR}/include/generated/)

foreach(inc_file
	ca_cert.pem
	client_cert.pem
	client_key.der
    )
  generate_inc_file_for_target(
    app
    ${CERTS_DIR}/${inc_file}
    ${gen_dir}/${inc_file}.inc
    )
endforeach()
```

## prj.conf
```kconfig
CONFIG_BACNETSTACK=y
CONFIG_HEAP_MEM_POOL_SIZE=80000
CONFIG_MAIN_STACK_SIZE=10000
CONFIG_INIT_STACKS=y

# Debugging stuff (can be commented out)
CONFIG_PRINTK=y
CONFIG_DEBUG=y
CONFIG_LOG=y
CONFIG_LOG_MODE_IMMEDIATE=y
CONFIG_LOG_PRINTK=y
CONFIG_LOG_DEFAULT_LEVEL=2
CONFIG_LOG_MODE_MINIMAL=y
#CONFIG_NO_OPTIMIZATIONS=y
CONFIG_ASSERT=n                        #does not work with CONFIG_LOG_MODE_IMMEDIATE=y

# Debug config (can be commented out)
CONFIG_NET_LOG=y
CONFIG_BACNETSTACK_LOG_LEVEL_ERR=y

#CONFIG_POSIX_API=y                   #does not work with CONFIG_BACDL_BSC=y
CONFIG_POSIX_MAX_FDS=10
#CONFIG_EXTERNAL_LIBC=n
#CONFIG_NEWLIB_LIBC=y
#CONFIG_NEWLIB_LIBC_NANO=n

# TLS configuration
CONFIG_MBEDTLS=y
CONFIG_MBEDTLS_BUILTIN=y
CONFIG_MBEDTLS_ENABLE_HEAP=y
CONFIG_MBEDTLS_HEAP_SIZE=64000
CONFIG_MBEDTLS_SSL_MAX_CONTENT_LEN=2048

CONFIG_MBEDTLS_ECP_C=y
CONFIG_MBEDTLS_ECDH_C=y
CONFIG_MBEDTLS_ECDSA_C=y
CONFIG_MBEDTLS_ECJPAKE_C=y

CONFIG_MBEDTLS_TLS_VERSION_1_2=y
CONFIG_MBEDTLS_KEY_EXCHANGE_ALL_ENABLED=y
CONFIG_MBEDTLS_CIPHER_ALL_ENABLED=y
CONFIG_MBEDTLS_ECP_ALL_ENABLED=y
CONFIG_MBEDTLS_MAC_ALL_ENABLED=y
CONFIG_MBEDTLS_GENPRIME_ENABLED=y
CONFIG_MBEDTLS_HMAC_DRBG_ENABLED=y
CONFIG_MBEDTLS_PEM_CERTIFICATE_FORMAT=y
#CONFIG_NET_SOCKETS_TLS_MAX_CONTEXTS=4

# Networking config
CONFIG_NETWORKING=y
CONFIG_NET_IPV4=y
CONFIG_NET_IPV6=n
CONFIG_NET_TCP=y
CONFIG_NET_SHELL=y
CONFIG_NET_STATISTICS=y
#CONFIG_NET_BUF_RX_COUNT=64
#CONFIG_NET_BUF_TX_COUNT=64
#CONFIG_NET_UDP=y
#CONFIG_SLIP_TAP=y

# Sockets
CONFIG_NET_SOCKETS=y
CONFIG_NET_SOCKETS_POSIX_NAMES=y
CONFIG_NET_SOCKETS_POLL_MAX=12
CONFIG_NET_SOCKETPAIR=y
CONFIG_NET_SOCKETPAIR_BUFFER_SIZE=16
CONFIG_NET_SOCKETS_SOCKOPT_TLS=y

# Network driver config
#CONFIG_TEST_RANDOM_GENERATOR=y
CONFIG_ENTROPY_GENERATOR=y

# Network address config
CONFIG_NET_CONFIG_SETTINGS=y
CONFIG_NET_CONFIG_NEED_IPV4=y
#CONFIG_NET_CONFIG_NEED_IPV6=y

CONFIG_NET_CONFIG_MY_IPV4_ADDR="192.0.2.1"
CONFIG_NET_CONFIG_MY_IPV4_GW="192.0.2.2"

# Address of HTTP IPv4 server
#CONFIG_NET_CONFIG_PEER_IPV4_ADDR="192.0.2.2"
#CONFIG_NET_CONFIG_MY_IPV6_ADDR="2001:db8::1"
# Address of HTTP IPv6 server
#CONFIG_NET_CONFIG_PEER_IPV6_ADDR="2001:db8::2"

# Bacnet Websocket
CONFIG_BACDL_BSC=y
CONFIG_WEBSOCKET_CLIENT=y

# Filesystem
CONFIG_FLASH=y
CONFIG_FLASH_MAP=y
CONFIG_FLASH_PAGE_LAYOUT=y
CONFIG_FILE_SYSTEM=y
CONFIG_FILE_SYSTEM_LITTLEFS=y
```

## boards/native_posix.overlay
```dts
/*
 * Copyright (c) 2022 Legrand North America, LLC.
 *
 * SPDX-License-Identifier: MIT
 *
 * @author Mikhail Antropov
 */

&storage_partition {
	reg = <0x000fc000 DT_SIZE_K(128)>;
};
```

## src/main.c
```c
/*
 * Copyright (c) 2022 Legrand North America, LLC.
 *
 * SPDX-License-Identifier: MIT
 */

/* @file
 * @author Mikhail Antropov
 * @brief Example server application using the BACnet Stack with Secure connect.
 */

#include <zephyr/kernel.h>
#include <zephyr/logging/log.h>
#include <zephyr/device.h>
#include <zephyr/fs/fs.h>
#include <zephyr/fs/littlefs.h>
#include <zephyr/storage/flash_map.h>

LOG_MODULE_DECLARE(bacnet, LOG_LEVEL_DBG);

#include <stdlib.h>
#include "bacnet/config.h"
#include "bacnet/apdu.h"
#include "bacnet/dcc.h"
#include "bacnet/iam.h"
#include "bacnet/version.h"
#include "bacnet/basic/services.h"
#include "bacnet/datalink/dlenv.h"
#include "bacnet/basic/tsm/tsm.h"
#include "bacnet/datalink/datalink.h"
#include "bacnet/basic/binding/address.h"
#include "bacnet/basic/object/bacfile.h"
#include "bacnet/basic/object/device.h"
#include "bacnet/basic/object/lc.h"
#include "bacnet/basic/object/trendlog.h"
#if defined(INTRINSIC_REPORTING)
#include "bacnet/basic/object/nc.h"
#endif /* defined(INTRINSIC_REPORTING) */

#include "bacnet/basic/object/netport.h"
#include "bacnet/basic/object/sc_netport.h"
#include "bacnet/datalink/bsc/bsc-event.h"

#define MNTP  "/lfs"
FS_LITTLEFS_DECLARE_DEFAULT_CONFIG(storage);
static struct fs_mount_t mnt = {
    .type = FS_LITTLEFS,
    .fs_data = &storage,
    .storage_dev = (void *)FIXED_PARTITION_ID(storage_partition),
    .mnt_point = MNTP,
};

static const uint8_t Ca_Certificate[] = {
    #include "ca_cert.pem.inc"
};
static const uint8_t Certificate[] = {
    #include "client_cert.pem.inc"
};
static const uint8_t Key[] = {
    #include "client_key.der.inc"
};

#define SERVER_URL "wss://192.0.2.2:50000"

#define DEVICE_INSTANCE 123
#define DEVICE_NAME "Fred"
#define FILENAME_CA_CERT    MNTP"/ca_cert.pem"
#define FILENAME_CERT       MNTP"/client_cert.pem"
#define FILENAME_KEY        MNTP"/client_key.pem"

/* current version of the BACnet stack */
static const char *BACnet_Version = BACNET_VERSION_TEXT;

/** Buffer used for receiving */
static uint8_t Rx_Buf[MAX_MPDU] = { 0 };

/** Initialize the handlers we will utilize.
 * @see Device_Init, apdu_set_unconfirmed_handler, apdu_set_confirmed_handler
 */
static void Init_Service_Handlers(void)
{
    Device_Init(NULL);
    /* we need to handle who-is to support dynamic device binding */
    apdu_set_unconfirmed_handler(SERVICE_UNCONFIRMED_WHO_IS, handler_who_is);
    apdu_set_unconfirmed_handler(SERVICE_UNCONFIRMED_WHO_HAS, handler_who_has);

#if 0
    /*  BACnet Testing Observed Incident oi00107
        Server only devices should not indicate that they EXECUTE I-Am
        Revealed by BACnet Test Client v1.8.16 ( www.bac-test.com/bacnet-test-client-download )
            BITS: BIT00040
        Any discussions can be directed to edward@bac-test.com
        Please feel free to remove this comment when my changes accepted after suitable time for
        review by all interested parties. Say 6 months -> September 2016 */
    /* In this demo, we are the server only ( BACnet "B" device ) so we do not indicate
       that we can execute the I-Am message */
    /* handle i-am to support binding to other devices */
    apdu_set_unconfirmed_handler(SERVICE_UNCONFIRMED_I_AM, handler_i_am_bind);
#endif

    /* set the handler for all the services we don't implement */
    /* It is required to send the proper reject message... */
    apdu_set_unrecognized_service_handler_handler(handler_unrecognized_service);
    /* Set the handlers for any confirmed services that we support. */
    /* We must implement read property - it's required! */
    apdu_set_confirmed_handler(
        SERVICE_CONFIRMED_READ_PROPERTY, handler_read_property);
    apdu_set_confirmed_handler(
        SERVICE_CONFIRMED_READ_PROP_MULTIPLE, handler_read_property_multiple);
    apdu_set_confirmed_handler(
        SERVICE_CONFIRMED_WRITE_PROPERTY, handler_write_property);
    apdu_set_confirmed_handler(
        SERVICE_CONFIRMED_WRITE_PROP_MULTIPLE, handler_write_property_multiple);
    apdu_set_confirmed_handler(
        SERVICE_CONFIRMED_READ_RANGE, handler_read_range);
#if defined(BACFILE)
    apdu_set_confirmed_handler(
        SERVICE_CONFIRMED_ATOMIC_READ_FILE, handler_atomic_read_file);
    apdu_set_confirmed_handler(
        SERVICE_CONFIRMED_ATOMIC_WRITE_FILE, handler_atomic_write_file);
#endif
    apdu_set_confirmed_handler(
        SERVICE_CONFIRMED_REINITIALIZE_DEVICE, handler_reinitialize_device);
    apdu_set_unconfirmed_handler(
        SERVICE_UNCONFIRMED_UTC_TIME_SYNCHRONIZATION, handler_timesync_utc);
    apdu_set_unconfirmed_handler(
        SERVICE_UNCONFIRMED_TIME_SYNCHRONIZATION, handler_timesync);
    apdu_set_confirmed_handler(
        SERVICE_CONFIRMED_SUBSCRIBE_COV, handler_cov_subscribe);
    apdu_set_unconfirmed_handler(
        SERVICE_UNCONFIRMED_COV_NOTIFICATION, handler_ucov_notification);
    /* handle communication so we can shutup when asked */
    apdu_set_confirmed_handler(SERVICE_CONFIRMED_DEVICE_COMMUNICATION_CONTROL,
        handler_device_communication_control);
    /* handle the data coming back from private requests */
    apdu_set_unconfirmed_handler(SERVICE_UNCONFIRMED_PRIVATE_TRANSFER,
        handler_unconfirmed_private_transfer);
#if defined(INTRINSIC_REPORTING)
    apdu_set_confirmed_handler(
        SERVICE_CONFIRMED_ACKNOWLEDGE_ALARM, handler_alarm_ack);
    apdu_set_confirmed_handler(
        SERVICE_CONFIRMED_GET_EVENT_INFORMATION, handler_get_event_information);
    apdu_set_confirmed_handler(
        SERVICE_CONFIRMED_GET_ALARM_SUMMARY, handler_get_alarm_summary);
#endif /* defined(INTRINSIC_REPORTING) */
#if defined(BACNET_TIME_MASTER)
    handler_timesync_init();
#endif
}

static int littlefs_flash_erase(unsigned int id)
{
    const struct flash_area *pfa;
    int rc;

    rc = flash_area_open(id, &pfa);
    if (rc < 0) {
        LOG_ERR("FAIL: unable to find flash area %u: %d\n",
            id, rc);
        return rc;
    }

    LOG_INF("Area %u at 0x%x on %s for %u bytes\n",
           id, (unsigned int)pfa->fa_off, pfa->fa_dev->name,
           (unsigned int)pfa->fa_size);

    /* Optional wipe flash contents */
    if (IS_ENABLED(CONFIG_APP_WIPE_STORAGE)) {
        rc = flash_area_erase(pfa, 0, pfa->fa_size);
        LOG_ERR("Erasing flash area ... %d", rc);
    }

    flash_area_close(pfa);
    return rc;
}

static int test_statvfs(char *str)
{
    struct fs_statvfs stat;
    int res;

    /* Verify fs_statvfs() */
    res = fs_statvfs(MNTP, &stat);
    if (res) {
        LOG_INF("Error getting volume stats [%d]", res);
        return res;
    }

    LOG_INF("%s", str);
    LOG_INF("Optimal transfer block size   = %lu", stat.f_bsize);
    LOG_INF("Allocation unit size          = %lu", stat.f_frsize);
    LOG_INF("Volume size in f_frsize units = %lu", stat.f_blocks);
    LOG_INF("Free space in f_frsize units  = %lu", stat.f_bfree);

    return 0;
}

static bool file_save(const char *name, const uint8_t *buffer,
    uint32_t buffer_size)
{
    struct fs_file_t file = {0};
    ssize_t brw;
    int status;

    status = fs_open(&file, name, FS_O_CREATE | FS_O_WRITE);
    if (status < 0) {
        LOG_INF("Failed opening file: %s, flag %d, errno=%d", name,
            FS_O_CREATE | FS_O_WRITE, status);
        test_statvfs("error open");
        return false;
    }

    brw = fs_write(&file, buffer, buffer_size);
    if (brw < 0) {
        LOG_INF("Failed writing to file: %s [%d]", name, (int)brw);
        test_statvfs("error write");
    }

    fs_close(&file);
    return brw >= 0;
}

static bool init_bsc(void)
{
    int rc;

    rc = littlefs_flash_erase((uintptr_t)mnt.storage_dev);
    if (rc < 0) {
        return false;
    }

    rc = fs_mount(&mnt);
    if (rc != 0) {
        LOG_INF("Error mounting fs [%d]", rc);
        return false;
    }

    if (!file_save(FILENAME_CA_CERT, Ca_Certificate, sizeof(Ca_Certificate)) ||
        !file_save(FILENAME_CERT, Certificate, sizeof(Certificate)) ||
        !file_save(FILENAME_KEY, Key, sizeof(Key))) {
        return false;
    }

    setenv("BACNET_SC_PRIMARY_HUB_URI", SERVER_URL, 1);
    setenv("BACNET_SC_FAILOVER_HUB_URI", SERVER_URL, 1);
    setenv("BACNET_SC_ISSUER_1_CERTIFICATE_FILE", FILENAME_CA_CERT, 1);
    setenv("BACNET_SC_OPERATIONAL_CERTIFICATE_FILE", FILENAME_CERT, 1);
    setenv("BACNET_SC_OPERATIONAL_CERTIFICATE_PRIVATE_KEY_FILE", FILENAME_KEY,
        1);

    return true;
}

void main(void)
{
    BACNET_ADDRESS src = { 0 }; /* address where message came from */
    uint16_t pdu_len = 0;
    unsigned timeout = 1; /* milliseconds */
    uint64_t last_msec = 0;
    uint64_t current_msec = 0;
    uint64_t elapsed_msec = 0;
    uint64_t elapsed_sec = 0;
    uint32_t address_binding_tmr = 0;
#if defined(INTRINSIC_REPORTING)
    uint32_t recipient_scan_tmr = 0;
#endif
#if defined(BACNET_TIME_MASTER)
    BACNET_DATE_TIME bdatetime;
#endif

    /* allow the device ID to be set */
    Device_Set_Object_Instance_Number(DEVICE_INSTANCE);

    LOG_INF("BACnet SC Server Demo\n"
           "BACnet Stack Version %s\n"
           "BACnet Device ID: %u\n"
           "Max APDU: %d\n",
        BACnet_Version, Device_Object_Instance_Number(), MAX_APDU);
    /* load any static address bindings to show up
       in our device bindings list */
    address_init();
    Init_Service_Handlers();

    Device_Object_Name_ANSI_Init(DEVICE_NAME);
    LOG_INF("BACnet Device Name: %s\n", DEVICE_NAME);

    bacfile_init();
    init_bsc();
    dlenv_init();
    LOG_INF("Connection to BACNet/SC hub established\n");
    atexit(datalink_cleanup);

    /* configure the timeout values */
    last_msec = k_uptime_get();
    /* broadcast an I-Am on startup */
    Send_I_Am(&Handler_Transmit_Buffer[0]);
    /* loop forever */
    for (;;) {
        /* input */
        current_msec = k_uptime_get();

        /* returns 0 bytes on timeout */
        pdu_len = datalink_receive(&src, &Rx_Buf[0], MAX_MPDU, timeout);

        /* process */
        if (pdu_len) {
            //printf("received pdu of size %d\n\n", pdu_len );
            npdu_handler(&src, &Rx_Buf[0], pdu_len);
        }
        /* at least one second has passed */
        elapsed_msec = (current_msec - last_msec);
        if (elapsed_msec > MSEC_PER_SEC) {
            last_msec = current_msec;
            elapsed_sec = elapsed_msec / MSEC_PER_SEC;
            dcc_timer_seconds(elapsed_sec);
            datalink_maintenance_timer(elapsed_sec);
            dlenv_maintenance_timer(elapsed_sec);
            Load_Control_State_Machine_Handler();
            handler_cov_timer_seconds(elapsed_sec);
            tsm_timer_milliseconds(elapsed_msec);
            trend_log_timer(elapsed_sec);
#if defined(INTRINSIC_REPORTING)
            Device_local_reporting();
#endif
#if defined(BACNET_TIME_MASTER)
            Device_getCurrentDateTime(&bdatetime);
            handler_timesync_task(&bdatetime);
#endif
        }
        handler_cov_task();
        /* scan cache address */
        address_binding_tmr += elapsed_sec;
        if (address_binding_tmr >= 60) {
            address_cache_timer(address_binding_tmr);
            address_binding_tmr = 0;
        }
#if defined(INTRINSIC_REPORTING)
        /* try to find addresses of recipients */
        recipient_scan_tmr += elapsed_sec;
        if (recipient_scan_tmr >= NC_RESCAN_RECIPIENTS_SECS) {
            Notification_Class_find_recipient();
            recipient_scan_tmr = 0;
        }
#endif
        /* output */

        /* blink LEDs, Turn on or off outputs, etc */
    }
}
```

## src/ca_cert_pem.h
```c
uint8_t Ca_Certificate[] = {
0x2D, 0x2D, 0x2D, 0x2D, 0x2D, 0x42, 0x45, 0x47, 0x49, 0x4E, 0x20, 0x43, 0x45, 0x52, 0x54, 0x49, 
0x46, 0x49, 0x43, 0x41, 0x54, 0x45, 0x2D, 0x2D, 0x2D, 0x2D, 0x2D, 0x0A, 0x4D, 0x49, 0x49, 0x42, 
0x35, 0x54, 0x43, 0x43, 0x41, 0x59, 0x75, 0x67, 0x41, 0x77, 0x49, 0x42, 0x41, 0x67, 0x49, 0x55, 
0x41, 0x38, 0x32, 0x75, 0x59, 0x78, 0x58, 0x45, 0x79, 0x35, 0x75, 0x78, 0x31, 0x6B, 0x4F, 0x4A, 
0x6A, 0x50, 0x70, 0x6D, 0x71, 0x51, 0x46, 0x61, 0x76, 0x45, 0x34, 0x77, 0x43, 0x67, 0x59, 0x49, 
0x4B, 0x6F, 0x5A, 0x49, 0x7A, 0x6A, 0x30, 0x45, 0x41, 0x77, 0x49, 0x77, 0x0A, 0x53, 0x44, 0x45, 
0x4C, 0x4D, 0x41, 0x6B, 0x47, 0x41, 0x31, 0x55, 0x45, 0x42, 0x68, 0x4D, 0x43, 0x56, 0x56, 0x4D, 
0x78, 0x43, 0x7A, 0x41, 0x4A, 0x42, 0x67, 0x4E, 0x56, 0x42, 0x41, 0x67, 0x4D, 0x41, 0x6B, 0x4E, 
0x42, 0x4D, 0x52, 0x41, 0x77, 0x44, 0x67, 0x59, 0x44, 0x56, 0x51, 0x51, 0x4B, 0x44, 0x41, 0x64, 
0x4D, 0x5A, 0x57, 0x64, 0x79, 0x59, 0x57, 0x35, 0x6B, 0x4D, 0x52, 0x6F, 0x77, 0x0A, 0x47, 0x41, 
0x59, 0x44, 0x56, 0x51, 0x51, 0x44, 0x44, 0x42, 0x46, 0x43, 0x51, 0x55, 0x4E, 0x4F, 0x5A, 0x58, 
0x51, 0x74, 0x55, 0x30, 0x4D, 0x67, 0x51, 0x30, 0x45, 0x67, 0x55, 0x6D, 0x39, 0x76, 0x64, 0x44, 
0x41, 0x65, 0x46, 0x77, 0x30, 0x79, 0x4D, 0x6A, 0x45, 0x79, 0x4D, 0x54, 0x59, 0x78, 0x4D, 0x7A, 
0x49, 0x79, 0x4D, 0x6A, 0x52, 0x61, 0x46, 0x77, 0x30, 0x79, 0x4E, 0x44, 0x45, 0x79, 0x0A, 0x4D, 
0x54, 0x55, 0x78, 0x4D, 0x7A, 0x49, 0x79, 0x4D, 0x6A, 0x52, 0x61, 0x4D, 0x45, 0x67, 0x78, 0x43, 
0x7A, 0x41, 0x4A, 0x42, 0x67, 0x4E, 0x56, 0x42, 0x41, 0x59, 0x54, 0x41, 0x6C, 0x56, 0x54, 0x4D, 
0x51, 0x73, 0x77, 0x43, 0x51, 0x59, 0x44, 0x56, 0x51, 0x51, 0x49, 0x44, 0x41, 0x4A, 0x44, 0x51, 
0x54, 0x45, 0x51, 0x4D, 0x41, 0x34, 0x47, 0x41, 0x31, 0x55, 0x45, 0x43, 0x67, 0x77, 0x48, 0x0A, 
0x54, 0x47, 0x56, 0x6E, 0x63, 0x6D, 0x46, 0x75, 0x5A, 0x44, 0x45, 0x61, 0x4D, 0x42, 0x67, 0x47, 
0x41, 0x31, 0x55, 0x45, 0x41, 0x77, 0x77, 0x52, 0x51, 0x6B, 0x46, 0x44, 0x54, 0x6D, 0x56, 0x30, 
0x4C, 0x56, 0x4E, 0x44, 0x49, 0x45, 0x4E, 0x42, 0x49, 0x46, 0x4A, 0x76, 0x62, 0x33, 0x51, 0x77, 
0x57, 0x54, 0x41, 0x54, 0x42, 0x67, 0x63, 0x71, 0x68, 0x6B, 0x6A, 0x4F, 0x50, 0x51, 0x49, 0x42, 
0x0A, 0x42, 0x67, 0x67, 0x71, 0x68, 0x6B, 0x6A, 0x4F, 0x50, 0x51, 0x4D, 0x42, 0x42, 0x77, 0x4E, 
0x43, 0x41, 0x41, 0x51, 0x55, 0x43, 0x67, 0x63, 0x37, 0x41, 0x36, 0x49, 0x4A, 0x74, 0x47, 0x34, 
0x50, 0x55, 0x2B, 0x36, 0x69, 0x54, 0x50, 0x7A, 0x4E, 0x42, 0x4D, 0x59, 0x71, 0x72, 0x50, 0x33, 
0x2B, 0x70, 0x73, 0x46, 0x56, 0x44, 0x61, 0x4C, 0x43, 0x46, 0x78, 0x36, 0x63, 0x4D, 0x55, 0x64, 
0x35, 0x0A, 0x5A, 0x52, 0x61, 0x44, 0x49, 0x38, 0x2B, 0x45, 0x5A, 0x78, 0x79, 0x76, 0x46, 0x42, 
0x2F, 0x57, 0x56, 0x6C, 0x6D, 0x69, 0x50, 0x30, 0x71, 0x41, 0x6F, 0x5A, 0x45, 0x75, 0x6D, 0x72, 
0x75, 0x68, 0x66, 0x46, 0x67, 0x55, 0x38, 0x6A, 0x67, 0x72, 0x6F, 0x31, 0x4D, 0x77, 0x55, 0x54, 
0x41, 0x64, 0x42, 0x67, 0x4E, 0x56, 0x48, 0x51, 0x34, 0x45, 0x46, 0x67, 0x51, 0x55, 0x6D, 0x75, 
0x35, 0x4D, 0x0A, 0x6A, 0x54, 0x4B, 0x76, 0x70, 0x6D, 0x67, 0x39, 0x34, 0x30, 0x76, 0x36, 0x2F, 
0x4E, 0x6D, 0x48, 0x66, 0x33, 0x39, 0x2B, 0x58, 0x4A, 0x34, 0x77, 0x48, 0x77, 0x59, 0x44, 0x56, 
0x52, 0x30, 0x6A, 0x42, 0x42, 0x67, 0x77, 0x46, 0x6F, 0x41, 0x55, 0x6D, 0x75, 0x35, 0x4D, 0x6A, 
0x54, 0x4B, 0x76, 0x70, 0x6D, 0x67, 0x39, 0x34, 0x30, 0x76, 0x36, 0x2F, 0x4E, 0x6D, 0x48, 0x66, 
0x33, 0x39, 0x2B, 0x0A, 0x58, 0x4A, 0x34, 0x77, 0x44, 0x77, 0x59, 0x44, 0x56, 0x52, 0x30, 0x54, 
0x41, 0x51, 0x48, 0x2F, 0x42, 0x41, 0x55, 0x77, 0x41, 0x77, 0x45, 0x42, 0x2F, 0x7A, 0x41, 0x4B, 
0x42, 0x67, 0x67, 0x71, 0x68, 0x6B, 0x6A, 0x4F, 0x50, 0x51, 0x51, 0x44, 0x41, 0x67, 0x4E, 0x49, 
0x41, 0x44, 0x42, 0x46, 0x41, 0x69, 0x45, 0x41, 0x38, 0x56, 0x6D, 0x52, 0x43, 0x68, 0x31, 0x62, 
0x71, 0x31, 0x71, 0x46, 0x0A, 0x59, 0x44, 0x71, 0x63, 0x5A, 0x78, 0x62, 0x62, 0x6F, 0x7A, 0x44, 
0x53, 0x65, 0x4E, 0x6D, 0x47, 0x51, 0x78, 0x30, 0x72, 0x4F, 0x6E, 0x37, 0x77, 0x4E, 0x41, 0x47, 
0x61, 0x52, 0x49, 0x30, 0x43, 0x49, 0x46, 0x36, 0x35, 0x45, 0x43, 0x45, 0x34, 0x4C, 0x6F, 0x50, 
0x78, 0x61, 0x78, 0x5A, 0x68, 0x55, 0x6A, 0x4C, 0x77, 0x44, 0x46, 0x53, 0x33, 0x64, 0x78, 0x70, 
0x4F, 0x57, 0x5A, 0x63, 0x74, 0x0A, 0x2B, 0x64, 0x66, 0x72, 0x51, 0x6E, 0x51, 0x52, 0x75, 0x69, 
0x4A, 0x71, 0x0A, 0x2D, 0x2D, 0x2D, 0x2D, 0x2D, 0x45, 0x4E, 0x44, 0x20, 0x43, 0x45, 0x52, 0x54, 
0x49, 0x46, 0x49, 0x43, 0x41, 0x54, 0x45, 0x2D, 0x2D, 0x2D, 0x2D, 0x2D, 0x0A 
};
```

## src/node_cert_pem.h
```c
uint8_t Certificate[] = {
0x2D, 0x2D, 0x2D, 0x2D, 0x2D, 0x42, 0x45, 0x47, 0x49, 0x4E, 0x20, 0x43, 0x45, 0x52, 0x54, 0x49, 
0x46, 0x49, 0x43, 0x41, 0x54, 0x45, 0x2D, 0x2D, 0x2D, 0x2D, 0x2D, 0x0A, 0x4D, 0x49, 0x49, 0x42, 
0x69, 0x54, 0x43, 0x43, 0x41, 0x53, 0x34, 0x43, 0x46, 0x42, 0x73, 0x65, 0x63, 0x78, 0x37, 0x72, 
0x33, 0x70, 0x37, 0x76, 0x33, 0x39, 0x78, 0x74, 0x74, 0x79, 0x69, 0x44, 0x55, 0x67, 0x77, 0x61, 
0x70, 0x50, 0x67, 0x47, 0x4D, 0x41, 0x6F, 0x47, 0x43, 0x43, 0x71, 0x47, 0x53, 0x4D, 0x34, 0x39, 
0x42, 0x41, 0x4D, 0x43, 0x4D, 0x45, 0x67, 0x78, 0x43, 0x7A, 0x41, 0x4A, 0x0A, 0x42, 0x67, 0x4E, 
0x56, 0x42, 0x41, 0x59, 0x54, 0x41, 0x6C, 0x56, 0x54, 0x4D, 0x51, 0x73, 0x77, 0x43, 0x51, 0x59, 
0x44, 0x56, 0x51, 0x51, 0x49, 0x44, 0x41, 0x4A, 0x44, 0x51, 0x54, 0x45, 0x51, 0x4D, 0x41, 0x34, 
0x47, 0x41, 0x31, 0x55, 0x45, 0x43, 0x67, 0x77, 0x48, 0x54, 0x47, 0x56, 0x6E, 0x63, 0x6D, 0x46, 
0x75, 0x5A, 0x44, 0x45, 0x61, 0x4D, 0x42, 0x67, 0x47, 0x41, 0x31, 0x55, 0x45, 0x0A, 0x41, 0x77, 
0x77, 0x52, 0x51, 0x6B, 0x46, 0x44, 0x54, 0x6D, 0x56, 0x30, 0x4C, 0x56, 0x4E, 0x44, 0x49, 0x45, 
0x4E, 0x42, 0x49, 0x46, 0x4A, 0x76, 0x62, 0x33, 0x51, 0x77, 0x48, 0x68, 0x63, 0x4E, 0x4D, 0x6A, 
0x49, 0x78, 0x4D, 0x6A, 0x45, 0x32, 0x4D, 0x54, 0x4D, 0x79, 0x4D, 0x6A, 0x49, 0x30, 0x57, 0x68, 
0x63, 0x4E, 0x4D, 0x7A, 0x49, 0x77, 0x4E, 0x7A, 0x45, 0x32, 0x4D, 0x54, 0x4D, 0x79, 0x0A, 0x4D, 
0x6A, 0x49, 0x30, 0x57, 0x6A, 0x42, 0x46, 0x4D, 0x51, 0x73, 0x77, 0x43, 0x51, 0x59, 0x44, 0x56, 
0x51, 0x51, 0x47, 0x45, 0x77, 0x4A, 0x56, 0x55, 0x7A, 0x45, 0x4C, 0x4D, 0x41, 0x6B, 0x47, 0x41, 
0x31, 0x55, 0x45, 0x43, 0x41, 0x77, 0x43, 0x51, 0x30, 0x45, 0x78, 0x45, 0x44, 0x41, 0x4F, 0x42, 
0x67, 0x4E, 0x56, 0x42, 0x41, 0x6F, 0x4D, 0x42, 0x30, 0x78, 0x6C, 0x5A, 0x33, 0x4A, 0x68, 0x0A, 
0x62, 0x6D, 0x51, 0x78, 0x46, 0x7A, 0x41, 0x56, 0x42, 0x67, 0x4E, 0x56, 0x42, 0x41, 0x4D, 0x4D, 
0x44, 0x6B, 0x4A, 0x42, 0x51, 0x30, 0x35, 0x6C, 0x64, 0x43, 0x31, 0x54, 0x51, 0x79, 0x42, 0x75, 
0x62, 0x32, 0x52, 0x6C, 0x4D, 0x46, 0x6B, 0x77, 0x45, 0x77, 0x59, 0x48, 0x4B, 0x6F, 0x5A, 0x49, 
0x7A, 0x6A, 0x30, 0x43, 0x41, 0x51, 0x59, 0x49, 0x4B, 0x6F, 0x5A, 0x49, 0x7A, 0x6A, 0x30, 0x44, 
0x0A, 0x41, 0x51, 0x63, 0x44, 0x51, 0x67, 0x41, 0x45, 0x43, 0x75, 0x6F, 0x59, 0x52, 0x4B, 0x72, 
0x75, 0x4B, 0x37, 0x64, 0x79, 0x73, 0x55, 0x4F, 0x42, 0x79, 0x6C, 0x76, 0x74, 0x52, 0x49, 0x65, 
0x63, 0x6C, 0x39, 0x66, 0x71, 0x43, 0x65, 0x6B, 0x79, 0x79, 0x55, 0x57, 0x74, 0x59, 0x47, 0x44, 
0x6E, 0x34, 0x65, 0x50, 0x42, 0x32, 0x47, 0x62, 0x61, 0x39, 0x34, 0x4A, 0x54, 0x59, 0x31, 0x65, 
0x5A, 0x0A, 0x6F, 0x75, 0x48, 0x6E, 0x62, 0x54, 0x46, 0x57, 0x59, 0x4B, 0x57, 0x33, 0x62, 0x62, 
0x69, 0x4C, 0x73, 0x57, 0x50, 0x44, 0x38, 0x4F, 0x6E, 0x43, 0x36, 0x73, 0x74, 0x61, 0x50, 0x7A, 
0x41, 0x4B, 0x42, 0x67, 0x67, 0x71, 0x68, 0x6B, 0x6A, 0x4F, 0x50, 0x51, 0x51, 0x44, 0x41, 0x67, 
0x4E, 0x4A, 0x41, 0x44, 0x42, 0x47, 0x41, 0x69, 0x45, 0x41, 0x70, 0x55, 0x67, 0x71, 0x42, 0x5A, 
0x7A, 0x36, 0x0A, 0x31, 0x67, 0x6F, 0x67, 0x43, 0x31, 0x76, 0x76, 0x5A, 0x55, 0x6D, 0x71, 0x44, 
0x55, 0x51, 0x7A, 0x4C, 0x31, 0x77, 0x64, 0x64, 0x49, 0x32, 0x63, 0x34, 0x58, 0x55, 0x62, 0x57, 
0x72, 0x6A, 0x69, 0x50, 0x61, 0x6B, 0x43, 0x49, 0x51, 0x43, 0x43, 0x55, 0x67, 0x34, 0x36, 0x5A, 
0x6A, 0x50, 0x36, 0x37, 0x4F, 0x2B, 0x44, 0x49, 0x75, 0x62, 0x54, 0x33, 0x4B, 0x70, 0x71, 0x4A, 
0x44, 0x6E, 0x37, 0x0A, 0x75, 0x31, 0x72, 0x64, 0x41, 0x36, 0x6D, 0x36, 0x64, 0x6A, 0x2B, 0x55, 
0x36, 0x71, 0x38, 0x37, 0x79, 0x67, 0x3D, 0x3D, 0x0A, 0x2D, 0x2D, 0x2D, 0x2D, 0x2D, 0x45, 0x4E, 
0x44, 0x20, 0x43, 0x45, 0x52, 0x54, 0x49, 0x46, 0x49, 0x43, 0x41, 0x54, 0x45, 0x2D, 0x2D, 0x2D, 
0x2D, 0x2D, 0x0A
};
```

## src/node_priv_key_der.h
```c
uint8_t Key[] = {
0x30, 0x77, 0x02, 0x01, 0x01, 0x04, 0x20, 0xA9, 0x43, 0xBE, 0xF2, 0xF6, 0xA6, 0x8E, 0xA2, 0x68, 
0x7C, 0x6A, 0x65, 0xCD, 0x21, 0x62, 0x50, 0xC8, 0x86, 0xED, 0x49, 0xFC, 0x0F, 0xCD, 0x72, 0xF5, 
0x06, 0x9E, 0x51, 0x26, 0x43, 0x95, 0xD6, 0xA0, 0x0A, 0x06, 0x08, 0x2A, 0x86, 0x48, 0xCE, 0x3D, 
0x03, 0x01, 0x07, 0xA1, 0x44, 0x03, 0x42, 0x00, 0x04, 0x0A, 0xEA, 0x18, 0x44, 0xAA, 0xEE, 0x2B, 
0xB7, 0x72, 0xB1, 0x43, 0x81, 0xCA, 0x5B, 0xED, 0x44, 0x87, 0x9C, 0x97, 0xD7, 0xEA, 0x09, 0xE9, 
0x32, 0xC9, 0x45, 0xAD, 0x60, 0x60, 0xE7, 0xE1, 0xE3, 0xC1, 0xD8, 0x66, 0xDA, 0xF7, 0x82, 0x53, 
0x63, 0x57, 0x99, 0xA2, 0xE1, 0xE7, 0x6D, 0x31, 0x56, 0x60, 0xA5, 0xB7, 0x6D, 0xB8, 0x8B, 0xB1, 
0x63, 0xC3, 0xF0, 0xE9, 0xC2, 0xEA, 0xCB, 0x5A, 0x3F
};
```
