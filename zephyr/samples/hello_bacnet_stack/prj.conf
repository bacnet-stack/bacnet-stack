## CMakeLists.txt
```
# SPDX-License-Identifier: MIT

cmake_minimum_required(VERSION 3.13.1)

get_filename_component(MY_PROJECT_NAME ${CMAKE_CURRENT_SOURCE_DIR} NAME)

find_package(Zephyr REQUIRED HINTS $ENV{ZEPHYR_BASE})
project(${MY_PROJECT_NAME})

target_sources(app PRIVATE src/main.c)
```

## sample.yaml
```
sample:
  description: Hello BACnet-Stack sample, the simplest BACnet-Stack
    application
  name: hello BACnet-Stack
common:
    tags: introduction
    harness: console
    integration_platforms:
      - native_posix
    harness_config:
      type: one_line
      regex:
        - "Hello BACnet-Stack! (.*)"
tests:
  bacnet-stack.sample.basic.hello_bacnet_stack:
    tags: introduction
```

## prj.conf
```kconfig
# nothing here
CONFIG_BACNETSTACK=y
```

## src/main.c
```c
/*
 * Copyright (c) 2020 Legrand North America, LLC.
 *
 * SPDX-License-Identifier: MIT
 */

#include <zephyr/kernel.h>
#include <zephyr/sys/printk.h>

void main(void)
{
    printk("Hello BACnet-Stack! %s\n", CONFIG_BOARD);
}
```
