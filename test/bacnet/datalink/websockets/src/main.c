/*
 * Copyright (c) 2020 Legrand North America, LLC.
 *
 * SPDX-License-Identifier: MIT
 */

/* @file
 * @brief test server/client websocket interface
 */

#include <stdlib.h>
#include <string.h>
#include <stdio.h>
#include <zephyr/ztest.h>
#include <bacnet/datalink/bsc/websocket.h>
#include <bacnet/datalink/bsc/bsc-event.h>

#define TEST_THREAD_NUM 10

unsigned char ca_key[] = {
    0x2d, 0x2d, 0x2d, 0x2d, 0x2d, 0x42, 0x45, 0x47, 0x49, 0x4e, 0x20, 0x52,
    0x53, 0x41, 0x20, 0x50, 0x52, 0x49, 0x56, 0x41, 0x54, 0x45, 0x20, 0x4b,
    0x45, 0x59, 0x2d, 0x2d, 0x2d, 0x2d, 0x2d, 0x0a, 0x4d, 0x49, 0x49, 0x45,
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    0x59, 0x2d, 0x2d, 0x2d, 0x2d, 0x2d, 0x0a
};

unsigned char ca_cert[] = { 0x2d,
                            0x2d,
                            0x2d,
                            0x2d,
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                            0x2d,
                            0x0a
#ifdef CONFIG_MBEDTLS
                            ,
                            0x00
#endif
};

unsigned char client_key[] = {
    0x2d, 0x2d, 0x2d, 0x2d, 0x2d, 0x42, 0x45, 0x47, 0x49, 0x4e, 0x20, 0x52,
    0x53, 0x41, 0x20, 0x50, 0x52, 0x49, 0x56, 0x41, 0x54, 0x45, 0x20, 0x4b,
    0x45, 0x59, 0x2d, 0x2d, 0x2d, 0x2d, 0x2d, 0x0a, 0x4d, 0x49, 0x49, 0x4a,
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    0x2d, 0x2d, 0x0a
};

unsigned char client_key_der[] = {
    0x30, 0x82, 0x09, 0x29, 0x02, 0x01, 0x00, 0x02, 0x82, 0x02, 0x01, 0x00,
    0xAF, 0x04, 0xB2, 0x36, 0x78, 0x5F, 0xBC, 0x38, 0x9C, 0x18, 0x93, 0x81,
    0x7D, 0x44, 0x0B, 0x18, 0x4A, 0x4A, 0x0B, 0x6F, 0xCD, 0xDB, 0x94, 0xE8,
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    0x09, 0x07, 0xFD, 0xC0, 0xE2, 0x39, 0x44, 0x8F, 0xF1
};

unsigned char client_cert[] = { 0x2d,
                                0x2d,
                                0x2d,
                                0x2d,
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                                0x2d,
                                0x0a
#ifdef CONFIG_MBEDTLS
                                ,
                                0x00
#endif
};

unsigned char server_key[] = { 0x2d,
                               0x2d,
                               0x2d,
                               0x2d,
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                               0x2d,
                               0x0a
#ifdef CONFIG_MBEDTLS
                               ,
                               0x00
#endif
};

unsigned char server_cert[] = { 0x2d,
                                0x2d,
                                0x2d,
                                0x2d,
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                                0x2d,
                                0x0a
#ifdef CONFIG_MBEDTLS
                                ,
                                0x00
#endif
};

#ifndef BSC_NETWORK_IFACE
#define BSC_NETWORK_IFACE "127.0.0.1"
#endif

#define BACNET_WEBSOCKET_SERVER_PORT 39000
#ifdef ZEPHYR_TEST
#define BACNET_WEBSOCKET_SERVER_ADDR CONFIG_NET_CONFIG_MY_IPV4_ADDR
#else
#define BACNET_WEBSOCKET_SERVER_ADDR "127.0.0.1"
#endif
#define INFINITE_TIMEOUT 10000000
#define DEFAULT_TIMEOUT 10
#define DEFAULT_WAIT_TIMEOUT_MS 100

// MbedTLS expects a key in DER format
#ifdef CONFIG_MBEDTLS
#define CLIENT_KEY client_key_der
#else
#define CLIENT_KEY client_key
#endif

typedef struct {
    BSC_WEBSOCKET_EVENT ev;
    BSC_WEBSOCKET_HANDLE h;
    BSC_WEBSOCKET_SRV_HANDLE sh;
    uint8_t in_buf[12 * 1024];
    size_t in_buf_size;
    uint8_t out_buf[12 * 1024];
    size_t out_buf_size;
} test_ctx_t;

static void wait_for_event(test_ctx_t *ctx, BSC_WEBSOCKET_EVENT ev)
{
    while (ctx->ev != ev) {
#ifdef ZEPHYR_TEST
        k_msleep(DEFAULT_WAIT_TIMEOUT_MS);
#else
        bsc_wait_ms(DEFAULT_WAIT_TIMEOUT_MS);
#endif
    }
    ctx->ev = -1;
}

static void cli_event(
    BSC_WEBSOCKET_HANDLE h,
    BSC_WEBSOCKET_EVENT ev,
    BACNET_ERROR_CODE ws_reason,
    char *ws_reason_desc,
    uint8_t *buf,
    size_t bufsize,
    void *user_param)
{
    test_ctx_t *ctx = (test_ctx_t *)user_param;
    BSC_WEBSOCKET_RET ret;
    (void)ws_reason;
    (void)ws_reason_desc;
    if (ev == BSC_WEBSOCKET_CONNECTED) {
        ctx->ev = BSC_WEBSOCKET_CONNECTED;
    } else if (ev == BSC_WEBSOCKET_SENDABLE) {
        uint8_t *p = malloc(sizeof(ctx->out_buf) + BSC_CONF_TX_PRE);
        memcpy(&p[BSC_CONF_TX_PRE], ctx->out_buf, ctx->out_buf_size);
        ret = bws_cli_dispatch_send(h, &p[BSC_CONF_TX_PRE], ctx->out_buf_size);
        zassert_equal(ret == BSC_WEBSOCKET_SUCCESS, true, 0);
        free(p);
    } else if (ev == BSC_WEBSOCKET_RECEIVED) {
        zassert_equal(sizeof(ctx->in_buf) >= bufsize, true, NULL);
        memcpy(ctx->in_buf, buf, bufsize);
        ctx->in_buf_size = bufsize;
        ctx->ev = BSC_WEBSOCKET_RECEIVED;
    } else if (ev == BSC_WEBSOCKET_DISCONNECTED) {
        ctx->ev = BSC_WEBSOCKET_DISCONNECTED;
    }
}

static void srv_event(
    BSC_WEBSOCKET_SRV_HANDLE sh,
    BSC_WEBSOCKET_HANDLE h,
    BSC_WEBSOCKET_EVENT ev,
    BACNET_ERROR_CODE ws_reason,
    char *ws_reason_desc,
    uint8_t *buf,
    size_t bufsize,
    void *user_param)
{
    test_ctx_t *ctx = (test_ctx_t *)user_param;
    BSC_WEBSOCKET_RET ret;
    (void)ws_reason;
    (void)ws_reason_desc;

    if (ev == BSC_WEBSOCKET_SERVER_STARTED) {
        ctx->ev = BSC_WEBSOCKET_SERVER_STARTED;
    } else if (ev == BSC_WEBSOCKET_SERVER_STOPPED) {
        ctx->ev = BSC_WEBSOCKET_SERVER_STOPPED;
    } else if (ev == BSC_WEBSOCKET_CONNECTED) {
        ctx->ev = BSC_WEBSOCKET_CONNECTED;
        ctx->h = h;
    } else if (ev == BSC_WEBSOCKET_SENDABLE) {
        uint8_t *p = malloc(sizeof(ctx->out_buf) + BSC_CONF_TX_PRE);
        memcpy(&p[BSC_CONF_TX_PRE], ctx->out_buf, ctx->out_buf_size);
        ret = bws_srv_dispatch_send(
            sh, h, &p[BSC_CONF_TX_PRE], ctx->out_buf_size);
        zassert_equal(ret, BSC_WEBSOCKET_SUCCESS, NULL);
        free(p);
    } else if (ev == BSC_WEBSOCKET_RECEIVED) {
        zassert_equal(sizeof(ctx->in_buf) >= bufsize, true, NULL);
        memcpy(ctx->in_buf, buf, bufsize);
        ctx->in_buf_size = bufsize;
        ctx->ev = BSC_WEBSOCKET_RECEIVED;
    }
}

static void fill_buf(uint8_t *buf, size_t bufsize, uint8_t shift)
{
    size_t i;
    for (i = 0; i < bufsize; i++) {
        buf[i] = (uint8_t)(i + shift);
    }
}

#if defined(CONFIG_ZTEST_NEW_API)
ZTEST(websocket_srv_test_1, test_simple)
#else
static void test_simple(void)
#endif
{
    BSC_WEBSOCKET_RET ret;
    static test_ctx_t cli_ctx;
    static test_ctx_t srv_ctx;
    BSC_WEBSOCKET_HANDLE h;
    char url[128];
    char ip_addr[128];
    uint16_t port;
    bool res;

    memset(&cli_ctx, 0, sizeof(cli_ctx));
    cli_ctx.ev = -1;
    cli_ctx.h = BSC_WEBSOCKET_INVALID_HANDLE;
    memset(&srv_ctx, 0, sizeof(srv_ctx));
    srv_ctx.ev = -1;
    srv_ctx.h = BSC_WEBSOCKET_INVALID_HANDLE;
    sprintf(
        url, "wss://%s:%d", BACNET_WEBSOCKET_SERVER_ADDR,
        BACNET_WEBSOCKET_SERVER_PORT);

    ret = bws_srv_start(
        BSC_WEBSOCKET_HUB_PROTOCOL, BACNET_WEBSOCKET_SERVER_PORT,
        BSC_NETWORK_IFACE, ca_cert, sizeof(ca_cert), server_cert,
        sizeof(server_cert), server_key, sizeof(server_key), DEFAULT_TIMEOUT,
        srv_event, &srv_ctx, &srv_ctx.sh);

    zassert_equal(ret, BSC_WEBSOCKET_SUCCESS, NULL);
    wait_for_event(&srv_ctx, BSC_WEBSOCKET_SERVER_STARTED);

    ret = bws_cli_connect(
        BSC_WEBSOCKET_HUB_PROTOCOL, url, ca_cert, sizeof(ca_cert), client_cert,
        sizeof(client_cert), CLIENT_KEY, sizeof(CLIENT_KEY), DEFAULT_TIMEOUT,
        cli_event, &cli_ctx, &h);

    zassert_equal(ret, BSC_WEBSOCKET_SUCCESS, NULL);
    wait_for_event(&cli_ctx, BSC_WEBSOCKET_CONNECTED);
    res = bws_srv_get_peer_ip_addr(
        srv_ctx.sh, srv_ctx.h, (uint8_t *)ip_addr, sizeof(ip_addr), &port);
    zassert_equal(res, true, NULL);
    /*printf("client %s:%d connected.\n", ip_addr, port);*/
    /*printf("client sending data...\n");*/
    cli_ctx.out_buf_size = sizeof(cli_ctx.out_buf);
    fill_buf(cli_ctx.out_buf, sizeof(cli_ctx.out_buf), 1);
    bws_cli_send(h);
    wait_for_event(&srv_ctx, BSC_WEBSOCKET_RECEIVED);
    zassert_equal(srv_ctx.in_buf_size, cli_ctx.out_buf_size, NULL);
    ret = memcmp(srv_ctx.in_buf, cli_ctx.out_buf, srv_ctx.in_buf_size);
    zassert_equal(ret, 0, NULL);

    /*printf("server sending data...\n");*/
    srv_ctx.out_buf_size = sizeof(srv_ctx.out_buf);
    fill_buf(srv_ctx.out_buf, sizeof(srv_ctx.out_buf), 2);
    bws_srv_send(srv_ctx.sh, srv_ctx.h);
    wait_for_event(&cli_ctx, BSC_WEBSOCKET_RECEIVED);
    zassert_equal(cli_ctx.in_buf_size, srv_ctx.out_buf_size, NULL);
    ret = memcmp(cli_ctx.in_buf, srv_ctx.out_buf, cli_ctx.in_buf_size);
    zassert_equal(ret, 0, NULL);

    bws_cli_disconnect(h);
    wait_for_event(&cli_ctx, BSC_WEBSOCKET_DISCONNECTED);

    ret = bws_srv_stop(srv_ctx.sh);
    zassert_equal(ret, BSC_WEBSOCKET_SUCCESS, NULL);
    wait_for_event(&srv_ctx, BSC_WEBSOCKET_SERVER_STOPPED);
}

#if defined(CONFIG_ZTEST_NEW_API)
ZTEST(websocket_srv_test_2, test_onoff)
#else
static void test_onoff(void)
#endif
{
    BSC_WEBSOCKET_RET ret;
    static test_ctx_t cli_ctx;
    static test_ctx_t srv_ctx;
    BSC_WEBSOCKET_HANDLE h;
    char url[128];

    memset(&cli_ctx, 0, sizeof(cli_ctx));
    cli_ctx.ev = -1;
    cli_ctx.h = BSC_WEBSOCKET_INVALID_HANDLE;
    memset(&srv_ctx, 0, sizeof(srv_ctx));
    srv_ctx.ev = -1;
    srv_ctx.h = BSC_WEBSOCKET_INVALID_HANDLE;
    sprintf(
        url, "wss://%s:%d", BACNET_WEBSOCKET_SERVER_ADDR,
        BACNET_WEBSOCKET_SERVER_PORT);

    ret = bws_srv_start(
        BSC_WEBSOCKET_HUB_PROTOCOL, BACNET_WEBSOCKET_SERVER_PORT, NULL, ca_cert,
        sizeof(ca_cert), server_cert, sizeof(server_cert), server_key,
        sizeof(server_key), DEFAULT_TIMEOUT, srv_event, &srv_ctx, &srv_ctx.sh);
    zassert_equal(ret, BSC_WEBSOCKET_SUCCESS, NULL);

    ret = bws_srv_stop(srv_ctx.sh);
    zassert_equal(ret, BSC_WEBSOCKET_SUCCESS, NULL);
    wait_for_event(&srv_ctx, BSC_WEBSOCKET_SERVER_STOPPED);

    ret = bws_cli_connect(
        BSC_WEBSOCKET_HUB_PROTOCOL, url, ca_cert, sizeof(ca_cert), client_cert,
        sizeof(client_cert), CLIENT_KEY, sizeof(CLIENT_KEY), DEFAULT_TIMEOUT,
        cli_event, &cli_ctx, &h);
    bws_cli_disconnect(h);
    wait_for_event(&cli_ctx, BSC_WEBSOCKET_DISCONNECTED);
}

#if defined(CONFIG_ZTEST_NEW_API)
ZTEST_SUITE(websocket_srv_test_1, NULL, NULL, NULL, NULL, NULL);
ZTEST_SUITE(websocket_srv_test_2, NULL, NULL, NULL, NULL, NULL);
#else
void test_main(void)
{
    // Tests must not be run in parallel threads!
    // Thats why tests functions are in different suites.

    ztest_test_suite(websocket_srv_test_1, ztest_unit_test(test_simple));
    ztest_test_suite(websocket_srv_test_2, ztest_unit_test(test_onoff));
    ztest_run_test_suite(websocket_srv_test_1);
    ztest_run_test_suite(websocket_srv_test_2);
}
#endif
